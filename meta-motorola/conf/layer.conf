## meta-shr-distro/conf/distro/shr.conf
```bitbake
#-----------------------------------------------------------------------------
#@TYPE: Distribution
#@NAME: SHR
#@DESCRIPTION: Linux Distribution Configuration for Mobile Phones
#-----------------------------------------------------------------------------

BB_LOCALCOUNT_OVERRIDE = ""
require conf/distro/include/preferred-shr-versions.inc
require conf/distro/include/defaulttunes.inc

#
# Header
#
DISTRO_NAME = "shr"
DISTRO_RELEASE = "2013.07-next"
DISTRO_VERSION = "${DISTRO_RELEASE}-${DATE}"
DISTRO_TYPE = "release"
DISTRO = "shr"

# meta/recipes-core/tasks/packagegroup-base.bb
VIRTUAL-RUNTIME_alsa-state = "fsoaudiod"

# meta/recipes-core/tasks/packagegroup-base.bb
VIRTUAL-RUNTIME_apm = "fso-apm"

# meta/recipes-core/tasks/packagegroup-core-boot.bb
VIRTUAL-RUNTIME_login_manager = "shadow util-linux-agetty"

# meta/recipes-core/tasks/packagegroup-core-boot.bb
VIRTUAL-RUNTIME_dev_manager = "udev udev-extraconf"

# meta/recipes-core/tasks/packagegroup-core-boot.bb
VIRTUAL-RUNTIME_init_manager = "systemd systemd-compat-units systemd-machine-units"

# meta/recipes-bsp/keymaps/keymaps_1.0.bb 
# meta/recipes-core/tasks/packagegroup-core-boot.bb 
# meta/recipes-sato/matchbox-sato/matchbox-session-sato_0.1.bb
VIRTUAL-RUNTIME_initscripts = ""
# To prevent bogus initscripts-function RDEPENDS from update-rc.d.bbclass
INHIBIT_UPDATERCD_BBCLASS = "1"

# meta/recipes-graphics/tasks/packagegroup-core-x11.bb
VIRTUAL-RUNTIME_graphical_init_manager = "xserver-nodm-init-systemd"

# meta-oe/recipes-core/tasks/packagegroup-x11_1.0.bb 
# meta/recipes-sato/tasks/packagegroup-core-x11-mini.bb 
# meta/recipes-sato/tasks/packagegroup-core-x11.bb
# meta/recipes-qt/qt4-graphics-system/qt4-graphics-system_1.0.bb
VIRTUAL-RUNTIME_xserver_common = "xserver-common"

# needed for webkit-efl
PACKAGECONFIG_append_pn-harfbuzz = " icu"

# we need this for systemd
KERNEL_ENABLE_CGROUPS ?= "1"

SYSTEMD_AUTO_RRECOMMENDS = "disable"

#Generate locales on the buildsystem instead of on the target. Speeds up first boot, set to "1" to enable
ENABLE_BINARY_LOCALE_GENERATION ?= "1"

# We only want to build UTF8 locales
LOCALE_UTF8_ONLY = "1"

# Yocto work around for missing ONLINE_PACKAGE_MANAGEMENT support, needed for testlab
ONLINE_PACKAGE_MANAGEMENT = "full"

#activate the blacklister
INHERIT += "blacklist"

# libfoo -> libfoo0-2 (etc)
INHERIT += "debian"

QA_LOG = "1"

# for blacklist from oe-core
PNBLACKLIST[udev]  = "udev is now provided by systemd recipe"
PNBLACKLIST[bluez-libs]  = "bluez-libs 3.x has been replaced by bluez4"
PNBLACKLIST[bluez-utils] = "bluez-utils 3.x has been replaced by bluez4"
PNBLACKLIST[atd] = "atd has been replaced by atd-over-fso"
PNBLACKLIST[qt4-x11-free-gles] = "qt4-x11-free is fine even without gles"
PNBLACKLIST[xserver-xf86-lite] = "xorg-xserver is preferred"
PNBLACKLIST[libiconv] = "libiconv is provided by LIBC"
PNBLACKLIST[libiconv-native] = "libiconv-native is provided by host LIBC (no provider in OE)"
PNBLACKLIST[gconf-dbus] = "gconf-dbus is provided by gconf"
PNBLACKLIST[gdbus-binding-tool] = "gdbus-binding-tool is provided by gdbus-codegen from glib itself"
PNBLACKLIST[gdbus-binding-tool-native] = "gdbus-binding-tool is provided by gdbus-codegen from glib-native itself"
PNBLACKLIST[external-csl-toolchain] = "use internal toolchain"
PNBLACKLIST[external-poky-toolchain] = "use internal toolchain"
PNBLACKLIST[sysvinit] = "use systemd now"
PNBLACKLIST[initscripts] = "use service file for systemd now"

SOURCE_MIRROR_URL = "http://build.shr-project.org/sources/"
INHERIT += "own-mirrors" 

# our subversion-native is new enough for this
FETCHCMD_svn = "/usr/bin/env svn --non-interactive --trust-server-cert"

DISTRO_FEED_PREFIX ?= "shr-next"
DISTRO_FEED_URI ?= "http://build.shr-project.org/shr-next/ipk"
DEPLOY_DIR_IMAGE = "${DEPLOY_DIR}/images/${MACHINE}"

ESYSACTIONS = "e-wm-sysactions-shr"
EMENU = "e-wm-menu-shr"
ECONFIG = "e-wm-config-illume2-shr"
ETHEME = "e-wm-theme-illume-gry"

# From minimal.conf

#############################################################################
# FEATURE SELECTION
#############################################################################
# We want images supporting the following features (for packagegroup-base)
DISTRO_FEATURES = "largefile ipv4 ipv6 wifi ppp ext2 vfat bluetooth usbgadget usbhost xattr"
# Following features are for ARM and E500 based machines
DISTRO_FEATURES += " eabi "
# Use-like features
DISTRO_FEATURES += " tk "
DISTRO_FEATURES += " x11 "
DISTRO_FEATURES += " alsa "
DISTRO_FEATURES += " pam "
DISTRO_FEATURES += " opengl "

# Inherit the default LIBC features superset from OE-core
DISTRO_FEATURES += "${DISTRO_FEATURES_LIBC}"

DISTRO_FEATURES += "systemd"
# in case http://patchwork.openembedded.org/patch/43209/ gets applied
DISTRO_FEATURES_BACKFILL_CONSIDERED += "sysvinit"
# sysvinit scripts are often missing in recipe
BAD_RECOMMENDATIONS += "update-rc.d"

# Enable gold like angstrom-bleeding does
DISTRO_FEATURES += "${LDISGOLD}"
LDISGOLD_arm = "ld-is-gold"
LDISGOLD_armv4 = ""
LDISGOLD_x86 = "ld-is-gold"
LDISGOLD_x86_64 = "ld-is-gold"
LDISGOLD = ""

#############################################################################
# Ensure MACHINE_CLASS is in OVERRIDES and is not empty as :: in OVERRIDES breaks order of OVERRIDES ie in FILESPATH
#############################################################################
MACHINE_CLASS ?= "${MACHINE}"
MACHINEOVERRIDES .= ":${MACHINE_CLASS}"
MACHINEOVERRIDES[vardepsexclude] = "MACHINE MACHINE_CLASS"
OVERRIDES[vardepsexclude] = "MACHINE MACHINE_CLASS"

#############################################################################
# Enable thumb for architectures where it makes sense
#############################################################################
# We can't set ARM_INSTRUCTION_SET_<override> directly since that will un-overridable in recipes like gcc
PREFERRED_ARM_INSTRUCTION_SET              ?= "thumb"
ARM_INSTRUCTION_SET = "${PREFERRED_ARM_INSTRUCTION_SET}"

#############################################################################
# PREFERRED PROVIDERS
#############################################################################
PREFERRED_PROVIDER_libcanberra-alsa = "libcanberra"
PREFERRED_PROVIDER_gpsd = "gpsd"
PREFERRED_PROVIDER_atd = "atd-over-fso"
PREFERRED_PROVIDER_glib-2.0-utils = "glib-2.0"
PREFERRED_PROVIDER_gconf-native = "gconf-native"
PREFERRED_PROVIDER_gconf-dbus = "gconf"
PREFERRED_PROVIDER_libfribidi = "libfribidi"
PREFERRED_PROVIDER_gconf = "gconf"
PREFERRED_PROVIDER_virtual/libx11 = "libx11"
PREFERRED_PROVIDER_virtual/xserver-xf86 = "xserver-xorg"
PREFERRED_PROVIDER_abiword = "abiword"
PREFERRED_PROVIDER_mplayer = "mplayer2"
PREFERRED_PROVIDER_virtual/fftw = "fftw"
# Prefer libjpeg-turbo
PREFERRED_PROVIDER_jpeg = "libjpeg-turbo"
PREFERRED_PROVIDER_jpeg-native = "libjpeg-turbo-native"
# until support for xf86-video-omap is enabled in our kernels
PREFERRED_PROVIDER_xf86-video-omapfb = "xf86-video-omapfb"

# Prefer udev from systemd recipe
PREFERRED_PROVIDER_udev = "systemd"

# virtual/libgl is used ie in xorg-xserver which is not MACHINE_ARCH so we need to keep it consistent across multiple machines using same xorg-xserver
PREFERRED_PROVIDER_virtual/libgl = "mesa"

# pango depends on virtual/libiconv and BBCLASSEXTEND=native makes virtual/libiconv-native from it and we don't want libiconv-native
ASSUME_PROVIDED += "virtual/libiconv-native"

#############################################################################
# CONTENTS
#############################################################################

# we need our own fs-perms *without* volatile for systemd
FILESYSTEM_PERMS_TABLES = "fs-perms-shr.txt"

DISTRO_EXTRA_APPS ?= ""

# Additional content I (only valid if you include packagegroup-base)
# distro-feed-configs: configuration files for the online feeds
# util-linux-mount util-linux-umount: busybox mount is broken
DISTRO_EXTRA_RDEPENDS += "\
  shr-version \
  distro-feed-configs \
  ${DISTRO_EXTRA_APPS} \
"
```

## meta-shr-distro/conf/layer.conf
```bitbake
# We have a conf and classes directory, append to BBPATH
BBPATH .= ":${LAYERDIR}"

# We have a recipes directory, add to BBFILES
BBFILES += "${LAYERDIR}/recipes*/*/*.bb ${LAYERDIR}/recipes*/*/*.bbappend"

BBFILE_COLLECTIONS += "shr-distro-layer"
BBFILE_PATTERN_shr-distro-layer := "^${LAYERDIR}/"
BBFILE_PRIORITY_shr-distro-layer = "7"

LAYERDEPENDS_shr-distro-layer = "core openembedded-layer efl-layer gnome-layer gpe-layer systemd-layer shr-layer fso-layer aurora-layer"

SIGGEN_EXCLUDE_SAFE_RECIPE_DEPS += "\
  intone->mplayer2 \
  intone->mplayer \
  mplayer2->linux-gta04 \
  mplayer2->linux-openmoko \
  mplayer2->linux-nokia900-meego \
  mplayer2->linux-samsung-crespo \
  mplayer2->linux-palmpre \
"
```

## meta-shr/conf/distro/include/defaulttunes.inc
```bitbake
# This is not included by distro config by default
# If you want more optimized feeds, dd this to local.conf:
# require meta-smartphone/meta-shr/conf/distro/include/defaulttunes.inc
# build image and reflash or at least rebuild opkg-config-base distro-feed-configs
# and opkg -force-reinstall opkg-config-base distro-feed-configs
# on target to get new /etc/opkg/arch.conf

DEFAULTTUNE_om-gta01 = "arm920t"
DEFAULTTUNE_om-gta02 = "arm920t"
DEFAULTTUNE_om-gta04 = "cortexa8t-neon"
DEFAULTTUNE_nokia900 = "cortexa8t-neon"
DEFAULTTUNE_crespo = "cortexa8t-neon"
DEFAULTTUNE_tuna = "cortexa8t-neon"

# or if you don't care about sharing binary feed between armv7a machines, 
# add this to local.conf after that require line
# DEFAULTTUNE_tuna = "cortexa9t-neon"
```
