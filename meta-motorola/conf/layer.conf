## meta-openmoko/conf/machine/om-gta02.conf
```bitbake
#-----------------------------------------------------------------------------
#@TYPE: Machine
#@NAME: Openmoko GTA02 (NeoFreerunner)
#@DESCRIPTION: Machine configuration for the Openmoko NeoFreerunner GSM phone
#-----------------------------------------------------------------------------

TARGET_ARCH = "arm"

PREFERRED_PROVIDER_virtual/kernel ?= "linux-openmoko"
MACHINE_KERNEL_PR = "r14"
PREFERRED_PROVIDER_virtual/xserver = "xserver-xorg"
PREFERRED_PROVIDER_virtual/libgl = "mesa-dri"

KERNEL_IMAGETYPE = "uImage"
UBOOT_ENTRYPOINT = "30008000"

MACHINE_FEATURES = "kernel26 apm alsa bluetooth gps usbgadget usbhost phone wifi vfat ext2"
MACHINE_DISPLAY_WIDTH_PIXELS = "480"
MACHINE_DISPLAY_HEIGHT_PIXELS = "640"
MACHINE_DISPLAY_ORIENTATION = "0"
MACHINE_DISPLAY_PPI = "285"
XSERVER ?= "xserver-xorg \
           xf86-input-evdev \
           xf86-video-glamo \
           xf86-input-keyboard \
           xf86-input-mouse"

# fbreader specific
READER_RESOLUTION = "480x640"
READER_ARCH       = "desktop"
READER_UI         = "gtk"

# package machine specific modules
MACHINE_EXTRA_RRECOMMENDS = "\
  kernel-module-s3cmci \
  kernel-module-snd-soc-neo1973-wm8753 \
  kernel-module-snd-soc-neo1973-gta02-wm8753 \
  kernel-module-snd-soc-dfbmcs320 \
  kernel-module-snd-soc-wm8753 \
  kernel-module-snd-soc-s3c24xx \
  kernel-module-s3c2410-udc \
  kernel-module-g-ether \
  kernel-module-ar6000 \
  kernel-module-leds-s3c24xx \
  kernel-module-leds-pwm \
  kernel-module-leds-gpio \
  kernel-module-btusb \
  kernel-module-hidp \
  kernel-module-bnep \
  kernel-module-rfcomm \
  kernel-module-bq27x00-battery \
  kernel-module-platform-battery \
"

# no need to bypass this as in om-gta01, since this model is not using a multiplexed ttySAC0
SERIAL_CONSOLE = "115200 ttySAC2"
USE_VT = "0"

# used by some images
ROOT_FLASH_SIZE = "256"

IMAGE_FSTYPES ?= "tar.gz jffs2 sum.jffs2 ubi"

# extra jffs2 tweaks
ERASEBLOCKSIZE = "0x20000"
EXTRA_IMAGECMD_jffs2 = "--little-endian --eraseblock=${ERASEBLOCKSIZE} --pagesize=0x800 --no-cleanmarkers --pad; \
  mv ${DEPLOY_DIR_IMAGE}/${IMAGE_NAME}.rootfs.jffs2 ${DEPLOY_DIR_IMAGE}/${IMAGE_NAME}.rootfs.jffs2.nosummary;"

EXTRA_IMAGECMD_sum.jffs2 = "--eraseblock=${ERASEBLOCKSIZE} --no-cleanmarkers --littleendian --pad "

# now we depend on jffs2 in IMAGE_FSTYPES before sum.jffs2
# see http://lists.linuxtogo.org/pipermail/openembedded-core/2011-December/014260.html
IMAGE_CMD_sum.jffs2_om-gta02 = "sumtool -i ${DEPLOY_DIR_IMAGE}/${IMAGE_NAME}.rootfs.jffs2.nosummary \
  -o ${DEPLOY_DIR_IMAGE}/${IMAGE_NAME}.rootfs.jffs2 -n ${EXTRA_IMAGECMD}; \
  ln -sf ${IMAGE_NAME}.rootfs.jffs2 ${DEPLOY_DIR_IMAGE}/${IMAGE_NAME}.rootfs.sum.jffs2"

# do ubiattach /dev/ubi_ctrl -m 4
# From dmesg:
# UBI: smallest flash I/O unit:    2048
# UBI: logical eraseblock size:    129024 bytes
# from ubiattach stdout:
# UBI device number 0, total 1996 LEBs
MKUBIFS_ARGS = "-m 2048 -e 126976 -c 2047"

# do ubiattach /dev/ubi_ctrl -m 4
# from dmesg:
# UBI: smallest flash I/O unit:    2048
# UBI: physical eraseblock size:   131072 bytes (128 KiB)
# UBI: sub-page size:              512
UBINIZE_ARGS = "-m 2048 -p 128KiB -s 2048 -O 2048"

# build / upload tools
EXTRA_IMAGEDEPENDS += "sjf2410-linux-native dfu-util-native qi qi-ubi qi-bootchart qi-debug"

# sound modules autoload
# be carefull module_autoload_%s needs to mach module filename 
# and there are
# mostly (200) underscores ie g_ether, s3c2410_ts, *tables modules (xt_iprange), cdc_ether
# sometimes (58) hyphen ie snd*, hid*, ums-* (ums-usbat), cdc-acm
# sometimes both ie nls_iso8859-2
module_autoload_snd-soc-neo1973-wm8753 = "snd-soc-s3c24xx snd_soc_s3c24xx_i2s snd-soc-dfbmcs320 snd-soc-wm8753 snd-soc-neo1973-wm8753"
module_autoload_ar6000 = "ar6000"
module_autoload_leds-s3c24xx = "leds-s3c24xx"
module_autoload_leds-pwm = "leds-pwm"
module_autoload_leds-gpio = "leds-gpio"

#for bluetooth
module_autoload_btusb = "btusb"
module_autoload_hidp = "hidp"
module_autoload_bnep = "bnep"
module_autoload_rfcomm = "rfcomm"

# usb
module_autoload_ohci-hcd = "ohci-hcd"
module_autoload_hci_usb = "hci_usb"
module_autoload_g_ether = "s3c2410_udc g_ether"
module_autoload_ppp_generic = "ppp_generic"
# snd modules module_autoload_snd-soc-neo1973-*-wm8753 are in machine.conf
# sd/mmc
module_autoload_s3cmci = "s3cmci"
# default battery driver
module_autoload_bq27x00_battery = "bq27x00-battery"

# tune for S3C24x0
include conf/machine/include/tune-arm920t.inc
```

## meta-openmoko/conf/machine/om-gta04.conf
```bitbake
#-----------------------------------------------------------------------------
#@TYPE: Machine
#@NAME: Openmoko GTA04 (Phoenux)
#@DESCRIPTION: Machine configuration for the Goldelico GTA04 GSM phone
#-----------------------------------------------------------------------------

TARGET_ARCH = "arm"
SOC_FAMILY = "omap3"
require conf/machine/include/tune-cortexa8.inc

PREFERRED_PROVIDER_virtual/kernel ?= "linux-gta04"
MACHINE_KERNEL_PR = "r6"
PREFERRED_PROVIDER_virtual/xserver = "xserver-xorg"
PREFERRED_PROVIDER_virtual/libgl = "mesa-dri"
# Override only for shr as it needs mesa-dri_git and ie angstrom has preferred_version set to 7.6

KERNEL_IMAGETYPE = "uImage"
UBOOT_ENTRYPOINT = "0x80008000"
UBOOT_LOADADDRESS = "0x80008000"
UBOOT_MACHINE = "omap3_gta04_config"

EXTRA_IMAGEDEPENDS += "u-boot"

# used by some images
ROOT_FLASH_SIZE = "505"

IMAGE_FSTYPES ?= "tar.gz jffs2 sum.jffs2"

# extra jffs2 tweaks
ERASEBLOCKSIZE = "0x20000"
EXTRA_IMAGECMD_jffs2 = "--little-endian --eraseblock=${ERASEBLOCKSIZE} --pagesize=0x800 --no-cleanmarkers --pad; \
  mv ${DEPLOY_DIR_IMAGE}/${IMAGE_NAME}.rootfs.jffs2 ${DEPLOY_DIR_IMAGE}/${IMAGE_NAME}.rootfs.jffs2.nosummary;"

EXTRA_IMAGECMD_sum.jffs2 = "--eraseblock=${ERASEBLOCKSIZE} --no-cleanmarkers --littleendian --pad "

# now we depend on jffs2 in IMAGE_FSTYPES before sum.jffs2
# see http://lists.linuxtogo.org/pipermail/openembedded-core/2011-December/014260.html
IMAGE_CMD_sum.jffs2_om-gta04 = "sumtool -i ${DEPLOY_DIR_IMAGE}/${IMAGE_NAME}.rootfs.jffs2.nosummary \
  -o ${DEPLOY_DIR_IMAGE}/${IMAGE_NAME}.rootfs.jffs2 -n ${EXTRA_IMAGECMD}; \
  ln -sf ${IMAGE_NAME}.rootfs.jffs2 ${DEPLOY_DIR_IMAGE}/${IMAGE_NAME}.rootfs.sum.jffs2"

MACHINE_FEATURES = "kernel26 apm alsa bluetooth gps usbgadget usbhost phone wifi vfat ext2"
MACHINE_DISPLAY_WIDTH_PIXELS = "480"
MACHINE_DISPLAY_HEIGHT_PIXELS = "640"
MACHINE_DISPLAY_ORIENTATION = "0"
MACHINE_DISPLAY_PPI = "285"
XSERVER ?= "xserver-xorg \
           xf86-input-evdev \
           xf86-video-omapfb \
           xf86-input-keyboard \
           xf86-input-mouse"

# fbreader specific
READER_RESOLUTION = "480x640"
READER_ARCH       = "desktop"
READER_UI         = "gtk"

# package machine specific modules
MACHINE_EXTRA_RRECOMMENDS = "\
  udev-gta04-rules \
  kernel-module-g-ether \
  kernel-module-bridge \
  kernel-module-hso \
  kernel-module-libertas-sdio \
"

SERIAL_CONSOLE = "115200 ttyO2"
USE_VT = "0"

# used by some images
ROOT_FLASH_SIZE = "256"

IMAGE_FSTYPES ?= "tar.gz ubi"

# do ubiattach /dev/ubi_ctrl -m 4
# From dmesg:
# UBI: smallest flash I/O unit:    2048
# UBI: logical eraseblock size:    129024 bytes
# from ubiattach stdout:
# UBI device number 0, total 1996 LEBs
MKUBIFS_ARGS = "-m 2048 -e 126976 -c 2047"

# do ubiattach /dev/ubi_ctrl -m 4
# from dmesg:
# UBI: smallest flash I/O unit:    2048
# UBI: physical eraseblock size:   131072 bytes (128 KiB)
# UBI: sub-page size:              512
UBINIZE_ARGS = "-m 2048 -p 128KiB -s 2048 -O 2048"


module_autoload_g_ether = "g_ether"
module_autoload_bridge = "bridge"
module_autoload_hso = "hso"
module_autoload_libertas_sdio = "libertas_sdio"
```
