## meta-palm/conf/machine/include/palmpre.inc
```bitbake
#@TYPE: Machine
#@NAME: Palm Pre Smartphone
#@DESCRIPTION: Machine configuration for the Palm Pre

TARGET_ARCH = "arm"
SOC_FAMILY = "omap3"

require conf/machine/include/tune-cortexa8.inc

# use this for overrides
MACHINE_CLASS = "palmpre"

PREFERRED_PROVIDER_virtual/xserver = "xserver-xorg"
XSERVER = "xserver-xorg \
           xf86-input-evdev \
           xf86-input-mouse \
           xf86-video-omapfb \
           xf86-input-keyboard"

MACHINE_DISPLAY_WIDTH_PIXELS = "320"
MACHINE_DISPLAY_HEIGHT_PIXELS = "480"
MACHINE_DISPLAY_ORIENTATION = "0"
MACHINE_DISPLAY_PPI = "185"

PREFERRED_PROVIDER_virtual/kernel = "linux-palmpre"

IMAGE_FSTYPES += "tar.gz"

MACHINE_FEATURES = "kernel26 screen apm usbgadget usbhost vfat alsa phone bluetooth touchscreen keyboard wifi"
MACHINE_EXTRA_RDEPENDS = " \
  tsmd \
  read-tokens \
  lvm2 \
  kernel-module-sirloin-wifi \
"
# marvell-license \
# marvell-sdio-fw \
# palmpre-audio-scripts \
# compat-wireless-2.6-old \

# Increase this everytime you change something in the kernel
MACHINE_KERNEL_PR = "r3"
KERNEL_IMAGETYPE = "uImage"
UBOOT_ENTRYPOINT = "80008000"
UBOOT_LOADADDRESS = "80008000"
```

## meta-qualcomm-modems/conf/layer.conf
```bitbake
# We have a conf and classes directory, append to BBPATH
BBPATH .= ":${LAYERDIR}"

# We have a recipes directory, add to BBFILES
BBFILES += "${LAYERDIR}/recipes*/*/*.bb ${LAYERDIR}/recipes*/*/*.bbappend"

BBFILE_COLLECTIONS += "qualcomm-modems-layer"
BBFILE_PATTERN_qualcomm-modems-layer := "^${LAYERDIR}/"
BBFILE_PRIORITY_qualcomm-modems-layer = "7"

LAYERDEPENDS_qualcomm-modems-layer = "core openembedded-layer"

LAYERSERIES_COMPAT_qualcomm-modems-layer = "langdale"
```

## meta-samsung/conf/machine/crespo.conf
```bitbake
#-----------------------------------------------------------------------------
#@TYPE: Machine
#@NAME: Samsung Crespo (also known as Nexus S)
#@DESCRIPTION: Machine configuration for the Samsung Crespo
#-----------------------------------------------------------------------------

TARGET_ARCH = "arm"

PREFERRED_PROVIDER_virtual/kernel ?= "linux-samsung-crespo"
MACHINE_KERNEL_PR = "r9"

MACHINE_FEATURES = "kernel26 apm alsa bluetooth gps usbgadget usbhost phone wifi vfat ext2 keyboard"
MACHINE_DISPLAY_WIDTH_PIXELS = "480"
MACHINE_DISPLAY_HEIGHT_PIXELS = "800"
MACHINE_DISPLAY_ORIENTATION = "0"
MACHINE_DISPLAY_PPI = "233"

MACHINE_EXTRA_RDEPENDS = " \
    kernel-module-bcm4329 \
    kernel-module-autofs4 \
    linux-bcm4329-firmware \
"

PREFERRED_PROVIDER_virtual/xserver = "xserver-xorg"
XSERVER = " \
    xserver-xorg \
    xf86-input-evdev \
    xf86-input-mtev \
    xf86-video-fbdev \
"

KERNEL_IMAGETYPE = "zImage"
IMAGE_FSTYPES += "tar.gz ext2"
IMAGE_ROOTFS_EXTRA_SPACE = "200000"

SERIAL_CONSOLE = "115200 ttyFIQ0"

require conf/machine/include/tune-cortexa8.inc
```

## meta-samsung/conf/machine/i9300.conf
```bitbake
#-----------------------------------------------------------------------------
#@TYPE: Machine
#@NAME: Samsung Galaxy SIII (International)
#@DESCRIPTION: Machine configuration for the Samsung Galaxy SIII
#-----------------------------------------------------------------------------

TARGET_ARCH = "arm"

PREFERRED_PROVIDER_virtual/kernel ?= "linux-samsung-i9300"

MACHINE_FEATURES = "apm alsa bluetooth gps usbgadget usbhost phone wifi vfat ext2 keyboard"
MACHINE_DISPLAY_WIDTH_PIXELS = "720"
MACHINE_DISPLAY_HEIGHT_PIXELS = "1280"
MACHINE_DISPLAY_ORIENTATION = "0"
MACHINE_DISPLAY_PPI = "306"

MACHINE_EXTRA_RDEPENDS = " \
    kernel-module-autofs4 \
"

PREFERRED_PROVIDER_virtual/xserver = "xserver-xorg"
XSERVER = " \
    xserver-xorg \
    xf86-input-evdev \
    xf86-video-fbdev \
"

KERNEL_IMAGETYPE = "zImage"
IMAGE_FSTYPES += "ext4"
IMAGE_ROOTFS_EXTRA_SPACE = "200000"

SERIAL_CONSOLES = "115200;ttySAC2"

require conf/machine/include/tune-cortexa9.inc
```

## meta-samsung/conf/machine/maguro.conf
```bitbake
#@TYPE: Machine
#@NAME: Samsung Maguro (also known as Galaxy Nexus GSM)
#@DESCRIPTION: Machine configuration for the Samsung Tuna

require conf/machine/include/tuna.inc

PREFERRED_PROVIDER_virtual/android-headers = "android-headers-maguro"
VIRTUAL-RUNTIME_android-system-image ?= "android-system-image-maguro"
```

## meta-samsung/conf/machine/toro.conf
```bitbake
#@TYPE: Machine
#@NAME: Samsung Toro (also known as Galaxy Nexus Verizon CDMA/LTE)
#@DESCRIPTION: Machine configuration for the Samsung Toro

require conf/machine/include/tuna.inc

VIRTUAL-RUNTIME_android-system-image ?= "android-system-image-toro"
```

## meta-samsung/conf/machine/toroplus.conf
```bitbake
#@TYPE: Machine
#@NAME: Samsung Toro Plus (also known as Galaxy Nexus Sprint CDMA/LTE)
#@DESCRIPTION: Machine configuration for the Samsung Toro Plus

require conf/machine/toro.conf
```

## meta-samsung/conf/machine/tuna.conf
```bitbake
#-----------------------------------------------------------------------------
#@TYPE: Machine
#@NAME: Samsung Tuna (also known as Galaxy Nexus)
#@DESCRIPTION: Machine configuration for the Samsung Tuna
#-----------------------------------------------------------------------------

TARGET_ARCH = "arm"

PREFERRED_PROVIDER_virtual/kernel ?= "linux-samsung-tuna"
MACHINE_KERNEL_PR = "r10"

MACHINE_FEATURES = "kernel26 apm alsa bluetooth gps usbgadget usbhost phone wifi vfat ext2 keyboard"
MACHINE_DISPLAY_WIDTH_PIXELS = "480"
MACHINE_DISPLAY_HEIGHT_PIXELS = "800"
MACHINE_DISPLAY_ORIENTATION = "0"
MACHINE_DISPLAY_PPI = "233"

MACHINE_EXTRA_RDEPENDS = " \
    kernel-module-autofs4 \
    samsung-tuna-firmware \
    alsa-ucm-conf-tuna \
"

PREFERRED_PROVIDER_virtual/egl ?= "libhybris"
PREFERRED_PROVIDER_virtual/libgles2 ?= "libhybris"
VIRTUAL-RUNTIME_android-system-image ?= "android-system-image-tuna"

PREFERRED_PROVIDER_virtual/xserver = "xserver-xorg"
XSERVER = " \
    xserver-xorg \
    xf86-input-evdev \
    xf86-video-omapfb \
"

KERNEL_IMAGETYPE = "zImage"
IMAGE_FSTYPES += "tar.gz ext2 ext4"
IMAGE_ROOTFS_EXTRA_SPACE = "200000"

SERIAL_CONSOLE = "115200 ttyFIQ0"

require conf/machine/include/tune-cortexa9.inc
```

## meta-shr-distro/conf/distro/include/defaulttunes.inc
```bitbake
# This is not included by distro config by default
# If you want more optimized feeds, dd this to local.conf:
# require meta-smartphone/meta-shr/conf/distro/include/defaulttunes.inc
# build image and reflash or at least rebuild opkg-config-base distro-feed-configs
# and opkg -force-reinstall opkg-config-base distro-feed-configs
# on target to get new /etc/opkg/arch.conf

DEFAULTTUNE_om-gta01 = "arm920t"
DEFAULTTUNE_om-gta02 = "arm920t"

DEFAULTTUNE_spitz    = "xscale"

DEFAULTTUNE_om-gta04 = "cortexa8t-neon"
DEFAULTTUNE_nokia900 = "cortexa8t-neon"
DEFAULTTUNE_crespo   = "cortexa8t-neon"
DEFAULTTUNE_tuna     = "cortexa8t-neon"

# or if you don't care about sharing binary feed between armv7a machines, 
# add this to local.conf after that require line
# DEFAULTTUNE_tuna = "cortexa9t-neon"

# For meta-shr-distro/recipes-core/meta/distro-feed-configs.bbappend:
# this is just to prevent opkg installing something from e.g. armv4t feed on armv7a,
# just because some upgrade was available in armv4t feed sooner and when it gets
# available for armv7a (same version) it's not reinstalled to get it from feed with higher priority
SUPPORTED_EXTRA_ARCHS_om-gta01 ?= "arm920tt"
SUPPORTED_EXTRA_ARCHS_om-gta02 ?= "arm920tt"

SUPPORTED_EXTRA_ARCHS_spitz    ?= "xscalete"

SUPPORTED_EXTRA_ARCHS_om-gta04 ?= "cortexa8t2-vfp-neon"
SUPPORTED_EXTRA_ARCHS_nokia900 ?= "cortexa8t2-vfp-neon"
SUPPORTED_EXTRA_ARCHS_crespo   ?= "cortexa8t2-vfp-neon"
SUPPORTED_EXTRA_ARCHS_tuna     ?= "cortexa8t2-vfp-neon"
```

## meta-shr-distro/conf/distro/include/preferred-shr-versions.inc
```bitbake
# we need new headers for libc, now OLDEST_KERNEL_linux-gnueabi = "2.6.24"
# and 2.6.31 for fsodeviced
OLDEST_KERNEL = "2.6.24"

PREFERRED_VERSION_libnl = "3%"

PREFERRED_VERSION_frameworkd = "0.10.99+git%"
PREFERRED_VERSION_frameworkd-config = "0.10.99+git%"
PREFERRED_VERSION_fsoaudiod = "0.12.99+git%"
PREFERRED_VERSION_fsodatad = "0.12.99+git%"
PREFERRED_VERSION_fsodeviced-modules = "0.12.99"
PREFERRED_VERSION_fsodeviced = "0.12.99+git%"
PREFERRED_VERSION_fsogsmd-modules = "0.12.99"
PREFERRED_VERSION_fsogsmd = "0.12.99+git%"
PREFERRED_VERSION_fsonetworkd = "0.12.99+git%"
PREFERRED_VERSION_fsosystemd = "0.12.99+git%"
PREFERRED_VERSION_fsotdld = "0.12.99+git%"
PREFERRED_VERSION_fsousaged = "0.12.99+git%"
PREFERRED_VERSION_libfsoframework = "0.12.99+git%"
```
