## meta-motorola/conf/layer.conf
```bitbake
# We have a conf and classes directory, append to BBPATH
BBPATH .= ":${LAYERDIR}"

# We have a recipes directory, add to BBFILES
BBFILES += "${LAYERDIR}/recipes*/*/*.bb ${LAYERDIR}/recipes*/*/*.bbappend"

BBFILE_COLLECTIONS += "motorola-layer"
BBFILE_PATTERN_motorola-layer := "^${LAYERDIR}/"
BBFILE_PRIORITY_motorola-layer = "7"

LAYERDEPENDS_motorola-layer = "core openembedded-layer android-layer"

LAYERSERIES_COMPAT_motorola-layer = "zeus"
```

## meta-nokia/conf/layer.conf
```bitbake
# We have a conf and classes directory, append to BBPATH
BBPATH .= ":${LAYERDIR}"

# We have a recipes directory, add to BBFILES
BBFILES += "${LAYERDIR}/recipes*/*/*.bb ${LAYERDIR}/recipes*/*/*.bbappend"

BBFILE_COLLECTIONS += "nokia-layer"
BBFILE_PATTERN_nokia-layer := "^${LAYERDIR}/"
BBFILE_PRIORITY_nokia-layer = "7"

LAYERDEPENDS_nokia-layer = "core openembedded-layer"
```

## meta-nokia/conf/machine/nokia900.conf
```bitbake
#@TYPE: Machine
#@NAME: Nokia 900 internet tablet
#@DESCRIPTION: Machine configuration for the Nokia 900

TARGET_ARCH = "arm"
SOC_FAMILY = "omap3"
require conf/machine/include/tune-cortexa8.inc


PREFERRED_PROVIDER_virtual/xserver = "xserver-xorg"
XSERVER = "xserver-xorg \
           xf86-input-evdev \
           xf86-video-fbdev \
           xf86-input-keyboard \
           xf86-video-omapfb "

MACHINE_EXTRA_RRECOMMENDS = "\
  watchdog \
  kernel-module-g-nokia \
  kernel-module-tsl2563 \
  kernel-module-smc91x \
  kernel-module-leds-lp5523 \
  kernel-module-adp1653 \
  kernel-module-ad5820 \
  kernel-module-et8ek8 \
  kernel-module-fmtx-si4713 \
  kernel-module-leds-twl4030-vibra \
  kernel-module-lis302dl \
  kernel-module-nokia-av \
  kernel-module-omap-ssi \
  kernel-module-omap-wdt \
  kernel-module-phonet \
  kernel-module-radio-bcm2048 \
  kernel-module-rtc-twl4030 \
  kernel-module-smia-sensor \
  kernel-module-ssi-mcsaab-imp \
  kernel-module-tsc2005 \
  kernel-module-twl4030-wdt \
  kernel-module-wl12xx \
  kernel-module-cmt-speech \
  kernel-module-gpio-keys \
  kernel-module-hci-h4p \
  kernel-module-hsi-char \
  kernel-module-isp1704-charger \
  kernel-module-lis3lv02d-i2c \
  kernel-module-mailbox-mach \
  kernel-module-rtc-twl \
  kernel-module-twl4030-pwrbutton \
  kernel-module-wl1251-spi \
  kernel-module-ubifs \
  kernel-module-af-packet \
  kernel-module-snd-soc-rx51 \
  kernel-module-snd-soc-tlv320aic3x \
  kernel-module-snd-soc-omap \
  kernel-module-musb-hdrc \
  kernel-module-twl4030-usb \
  kernel-module-bq27x00-battery \
  kernel-module-cmt-speech \
  kernel-module-pvrsrvkm \
  kernel-module-aes-generic \
  kernel-module-omap3-isp \
  kernel-module-pn-pep \
"

GUI_MACHINE_CLASS = "bigscreen"
MACHINE_DISPLAY_WIDTH_PIXELS = "800"
MACHINE_DISPLAY_HEIGHT_PIXELS = "480"

KERNEL_IMAGETYPE = "uImage"

UBOOT_ENTRYPOINT = "0x80008000"
UBOOT_LOADADDRESS = "0x80008000"
EXTRA_IMAGEDEPENDS += "u-boot"

ROOT_FLASH_SIZE = "100"
EXTRA_IMAGECMD_jffs2_nokia900 = "--pad --little-endian --eraseblock=0x20000 -n"

# Add "rootfstype=ubifs ubi.mtd=5,2048 root=ubi0:nokia900-rootfs"
# to the kernel cmdline to boot an ubifs image flashed on /dev/mtd5
# Here are the arguments with the corresponding dmesg messages :
# -m: UBI: smallest flash I/O unit:    2048
# -e: UBI: logical eraseblock size:    126976 bytes
# -c: UBI: number of good PEBs:        2009
# -p: UBI: physical eraseblock size:   131072 bytes (128 KiB)
# -x: best compression ratio
# -s and -O : set to the smallest flash I/O unit to bypass the subpages
# See http://www.linux-mtd.infradead.org/faq/ubi.html#L_vid_offset_mismatch for more details
# else you have some errors like theses in dmesg with ubiattach:
# onenand_write_ops_nolock: verify failed -74
# UBI error: ubi_io_write: error -74 while writing 512 bytes to PEB 961:512, written 512 bytes
# UBI warning: ubi_eba_write_leb: failed to write VID header to LEB 2147479551:0, PEB 961
# UBI warning: ubi_ro_mode: switch to read-only mode
MKUBIFS_ARGS = "-m 2048 -e 126976 -c 2009 -x zlib"
UBINIZE_ARGS = "-m 2048 -p 131072 -s 2048 -O 2048"

IMAGE_FSTYPES ?= "jffs2 tar.gz"

PREFERRED_PROVIDER_virtual/kernel = "linux-nokia900-meego"

#use this if you are using the nokia initfs
ROOTFS_POSTPROCESS_COMMAND += " remove_init_link; "

MACHINE_FEATURES = "kernel26 apm alsa bluetooth usbgadget vfat keyboard"

module_autoload_rtc-twl = "rtc-twl"
module_autoload_g-nokia = "g-nokia"
module_autoload_omap_ssi = "omap-ssi"
module_autoload_isp1704_charger = "isp1704-charger"
module_autoload_bq27x00_battery = "bq27x00-battery"
module_autoload_wl1251_spi = "wl1251-spi"
module_autoload_cmt_speech = "cmt-speech"
module_autoload_hsi_char = "hsi-char"
module_autoload_aes_generic = "aes-generic"
module_autoload_hci_h4p = "hci-h4p"
module_autoload_leds-lp5523 = "leds-lp5523"
module_autoload_lis3lv02d_i2c = "lis3lv02d-i2c"
module_autoload_pvrsrvkm = "pvrsrvkm"
module_autoload_smc91x = "smc91x"
module_autoload_tsl2563 = "tsl2563"
module_autoload_omap3-isp = "omap3-isp"
module_autoload_pn_pep = "pn-pep"

# not in 2.6.37+gitr1+7b81b4d55839514f2d801cd06855c8d422cfc3ac-r66, check _/-
module_autoload_musb_hdrc = "musb-hdrc"
module_autoload_twl4030_usb = "twl4030-usb"
module_autoload_twl4030_vibra = "twl4030-vibra"
module_autoload_af_packet = "af-packet"
module_autoload_snd-soc-rx51 = "snd-soc-rx51"
module_autoload_snd-soc-tlv320aic3x = "snd-soc-tlv320aic3x"
module_autoload_snd-soc-omap = "snd-soc-omap"

# Copied from include/omap3.inc (as we do not use linux-omap recipes):
#
# Increase this everytime you change something in the kernel
MACHINE_KERNEL_PR = "r67"
./drivers/hwmon/lis3lv02d.ko
./drivers/hwmon/lis3lv02d_i2c.ko
./drivers/hsi/controllers/omap_ssi.ko
./drivers/hsi/clients/ssi_protocol.ko
./drivers/hsi/clients/cmt_speech.ko
./drivers/hsi/clients/hsi_char.ko
./drivers/gpu/pvr/pvrsrvkm.ko
./drivers/leds/leds-lp5523.ko
./drivers/media/media.ko
./drivers/media/video/smia-sensor.ko
./drivers/media/video/smiaregs.ko
./drivers/media/video/isp/omap3-isp.ko
./drivers/media/video/ad5820.ko
./drivers/media/video/v4l2-common.ko
./drivers/media/video/videodev.ko
./drivers/media/video/adp1653.ko
./drivers/media/video/et8ek8.ko
./drivers/staging/iio/light/tsl2563.ko
./drivers/staging/iio/industrialio.ko
./drivers/rtc/rtc-twl.ko
./drivers/input/input-polldev.ko
./drivers/misc/cmt/cmt.ko
./drivers/net/wireless/wl1251/wl1251.ko
./drivers/net/wireless/wl1251/wl1251_spi.ko
./drivers/net/mii.ko
./drivers/net/smc91x.ko
./drivers/net/tun.ko
./drivers/usb/gadget/g_file_storage.ko
./drivers/usb/gadget/gadgetfs.ko
./drivers/usb/gadget/g_ether.ko
./drivers/usb/gadget/g_nokia.ko
./drivers/power/bq27x00_battery.ko
./drivers/power/isp1704_charger.ko
./drivers/power/power_supply.ko
./drivers/bluetooth/hci_h4p/hci_h4p.ko
./arch/arm/plat-omap/mailbox.ko
./arch/arm/mach-omap2/mailbox_mach.ko
./crypto/aes_generic.ko
./fs/fat/fat.ko
./fs/fat/vfat.ko
./fs/fat/msdos.ko
./fs/ubifs/ubifs.ko
./net/wireless/cfg80211.ko
./net/ipv6/ipv6.ko
./net/phonet/phonet.ko
./net/phonet/pn_pep.ko
./net/mac80211/mac80211.ko
./net/rfkill/rfkill.ko
./net/bluetooth/sco.ko
./net/bluetooth/rfcomm/rfcomm.ko
./net/bluetooth/bluetooth.ko
./net/bluetooth/bnep/bnep.ko
./net/bluetooth/l2cap.ko
```
