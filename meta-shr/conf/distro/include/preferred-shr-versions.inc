## meta-shr/conf/distro/include/preferred-shr-versions.inc
```bitbake
# we need new headers for libc, now OLDEST_KERNEL_linux-gnueabi = "2.6.24"
# and 2.6.31 for fsodeviced
OLDEST_KERNEL = "2.6.24"

# We need git version of tslib as the old 1.0 release does not the support the features we
# need for some mobile handset devices
PREFERRED_VERSION_tslib = "1.0+git%"

PREFERRED_VERSION_libnl = "3%"
```

## meta-shr/conf/distro/shr.conf
```bitbake
#-----------------------------------------------------------------------------
#@TYPE: Distribution
#@NAME: SHR
#@DESCRIPTION: Linux Distribution Configuration for Mobile Phones
#-----------------------------------------------------------------------------

BB_LOCALCOUNT_OVERRIDE = ""
require conf/distro/include/preferred-shr-versions.inc
require conf/distro/include/efl-from-svn.inc

#
# Header
#
DISTRO_NAME = "shr"
DISTRO_VERSION = "${DATE}"
DISTRO_TYPE = "release"
DISTRO = "shr"

# When changing this bump PRINC for (or better git grep for them all):
# meta/recipes-core/tasks/task-base.bb
VIRTUAL-RUNTIME_alsa-state = "fsoaudiod"

# When changing this bump PRINC for (or better git grep for them all):
# meta/recipes-core/tasks/task-base.bb
VIRTUAL-RUNTIME_apm = "fso-apm"

# When changing this bump PRINC for (or better git grep for them all):
# meta/recipes-core/tasks/task-core-boot.bb
VIRTUAL-RUNTIME_login_manager = "shadow util-linux-agetty"

# When changing this bump PRINC for (or better git grep for them all):
# meta/recipes-core/tasks/task-core-boot.bb
VIRTUAL-RUNTIME_dev_manager = ""

# When changing this bump PRINC for (or better git grep for them all):
# meta/recipes-core/tasks/task-core-boot.bb
VIRTUAL-RUNTIME_init_manager = "sysvinit sysvinit-pidof"

# When changing this bump PRINC for (or better git grep for them all):
# meta/recipes-bsp/keymaps/keymaps_1.0.bb 
# meta/recipes-core/tasks/task-core-boot.bb 
# meta/recipes-sato/matchbox-sato/matchbox-session-sato_0.1.bb
VIRTUAL-RUNTIME_initscripts = "initscripts"

# When changing this bump PRINC for (or better git grep for them all):
# meta-oe/recipes-core/tasks/task-x11_1.0.bb 
# meta/recipes-sato/tasks/task-core-x11-mini.bb 
# meta/recipes-sato/tasks/task-core-x11.bb
VIRTUAL-RUNTIME_graphical_init_manager = "xserver-nodm-init"

# When changing this bump PRINC for (or better git grep for them all):
# meta-oe/recipes-core/tasks/task-x11_1.0.bb 
# meta/recipes-sato/tasks/task-core-x11-mini.bb 
# meta/recipes-sato/tasks/task-core-x11.bb
# meta/recipes-qt/qt4-graphics-system/qt4-graphics-system_1.0.bb
VIRTUAL-RUNTIME_xserver_common = "xserver-common"

# we need this for systemd
KERNEL_ENABLE_CGROUPS ?= "1"

#Generate locales on the buildsystem instead of on the target. Speeds up first boot, set to "1" to enable
ENABLE_BINARY_LOCALE_GENERATION ?= "1"

# We only want to build UTF8 locales
LOCALE_UTF8_ONLY = "1"

# Yocto work around for missing ONLINE_PACKAGE_MANAGEMENT support, needed for testlab
ONLINE_PACKAGE_MANAGEMENT = "full"

#activate the blacklister
INHERIT += "blacklist"

# libfoo -> libfoo0-2 (etc)
INHERIT += "debian"

QA_LOG = "1"

ANGSTROM_BLACKLIST_pn-bluez-libs  = "bluez-libs 3.x has been replaced by bluez4"
ANGSTROM_BLACKLIST_pn-bluez-utils = "bluez-utils 3.x has been replaced by bluez4"
ANGSTROM_BLACKLIST_pn-atd = "atd has been replaced by atd-over-fso"
ANGSTROM_BLACKLIST_pn-qt4-x11-free-gles = "qt4-x11-free is fine even without gles"
ANGSTROM_BLACKLIST_pn-xserver-xf86-lite = "xorg-xserver is preferred"
ANGSTROM_BLACKLIST_pn-libiconv = "libiconv is provided by LIBC"
ANGSTROM_BLACKLIST_pn-libiconv-native = "libiconv-native is provided by host LIBC (no provider in OE)"
ANGSTROM_BLACKLIST_pn-gconf-dbus = "gconf-dbus is provided by gconf"
ANGSTROM_BLACKLIST_pn-gdbus-binding-tool = "gdbus-binding-tool is provided by gdbus-codegen from glib itself"
ANGSTROM_BLACKLIST_pn-gdbus-binding-tool-native = "gdbus-binding-tool is provided by gdbus-codegen from glib-native itself"
ANGSTROM_BLACKLIST_pn-external-csl-toolchain = "use internal toolchain"
ANGSTROM_BLACKLIST_pn-external-poky-toolchain = "use internal toolchain"

#The shr-mirrors.bbclass repleaces this
#PREMIRRORS = "(ftp|https?)$://.*/.* http://build.shr-project.org/sources/"
INHERIT += "shr-mirrors" 

# our subversion-native is new enough for this
FETCHCMD_svn = "/usr/bin/env svn --non-interactive --trust-server-cert"

# bump PRINC in meta-shr/recipes-core/meta/distro-feed-configs.bbappend after changing this
DISTRO_FEED_PREFIX ?= "shr-2012.01"
DISTRO_FEED_URI ?= "http://build.shr-project.org/shr-2012.01/ipk"
DEPLOY_DIR_IMAGE = "${DEPLOY_DIR}/images/${MACHINE}"

ESYSACTIONS = "e-wm-sysactions-shr"
EMENU = "e-wm-menu-shr"
ECONFIG = "e-wm-config-illume2-shr"
ETHEME = "e-wm-theme-illume-gry"

# From minimal.conf

#############################################################################
# FEATURE SELECTION
#############################################################################
# We want images supporting the following features (for task-base)
DISTRO_FEATURES = "largefile ipv4 ipv6 wifi ppp ext2 vfat bluetooth usbgadget usbhost xattr"
# Following features are for ARM and E500 based machines
DISTRO_FEATURES += " eabi "
# Use-like features
DISTRO_FEATURES += " tk "
DISTRO_FEATURES += " x11 "
DISTRO_FEATURES += " pam "

# Inherit the default LIBC features superset from OE-core
DISTRO_FEATURES += "${DISTRO_FEATURES_LIBC}"

# Enable gold like angstrom-bleeding does
DISTRO_FEATURES += "${LDISGOLD}"
LDISGOLD_arm = "ld-is-gold"
LDISGOLD_armv4 = ""
LDISGOLD_x86 = "ld-is-gold"
LDISGOLD_x86_64 = "ld-is-gold"
LDISGOLD = ""

#############################################################################
# Ensure MACHINE_CLASS is in OVERRIDES and is not empty as :: in OVERRIDES breaks order of OVERRIDES ie in FILESPATH
#############################################################################
MACHINE_CLASS ?= "${MACHINE}"
MACHINEOVERRIDES .= ":${MACHINE_CLASS}"
MACHINEOVERRIDES[vardepsexclude] = "MACHINE MACHINE_CLASS"
OVERRIDES[vardepsexclude] = "MACHINE MACHINE_CLASS"

#############################################################################
# Enable thumb for architectures where it makes sense
#############################################################################
# We can't set ARM_INSTRUCTION_SET_<override> directly since that will un-overridable in recipes like gcc
PREFERRED_ARM_INSTRUCTION_SET              ?= "thumb"
ARM_INSTRUCTION_SET = "${PREFERRED_ARM_INSTRUCTION_SET}"

#############################################################################
# PREFERRED PROVIDERS
#############################################################################
PREFERRED_PROVIDER_libcanberra-alsa = "libcanberra"
PREFERRED_PROVIDER_gpsd = "fso-gpsd"
PREFERRED_PROVIDER_atd = "atd-over-fso"
PREFERRED_PROVIDER_glib-2.0-utils = "glib-2.0"
PREFERRED_PROVIDER_gconf-native = "gconf-native"
PREFERRED_PROVIDER_gconf-dbus = "gconf"
PREFERRED_PROVIDER_libfribidi = "libfribidi"
PREFERRED_PROVIDER_gconf = "gconf"
PREFERRED_PROVIDER_virtual/libx11 = "libx11"
PREFERRED_PROVIDER_virtual/xserver-xf86 = "xserver-xorg"
PREFERRED_PROVIDER_abiword = "abiword"
PREFERRED_PROVIDER_mplayer = "mplayer2"
# Prefer libjpeg-turbo
PREFERRED_PROVIDER_jpeg = "libjpeg-turbo"
PREFERRED_PROVIDER_jpeg-native = "libjpeg-turbo-native"

# virtual/libgl is used ie in xorg-xserver which is not MACHINE_ARCH so we need to keep it consistent across multiple machines using same xorg-xserver
PREFERRED_PROVIDER_virtual/libgl = "mesa-dri"

# pango depends on virtual/libiconv and BBCLASSEXTEND=native makes virtual/libiconv-native from it and we don't want libiconv-native
ASSUME_PROVIDED += "virtual/libiconv-native"

#############################################################################
# CONTENTS
#############################################################################

# pulls udev to image
BAD_RECOMMENDATIONS += "gpsd-udev"

DISTRO_EXTRA_APPS ?= ""

# Additional content I (only valid if you include task-base)
# distro-feed-configs: configuration files for the online feeds
# util-linux-mount util-linux-umount: busybox mount is broken
DISTRO_EXTRA_RDEPENDS += "\
  shr-version \
  distro-feed-configs \
  ${DISTRO_EXTRA_APPS} \
"
```

## meta-shr/conf/layer.conf
```bitbake
# We have a conf and classes directory, append to BBPATH
BBPATH .= ":${LAYERDIR}"

# We have a recipes directory, add to BBFILES
BBFILES += "${LAYERDIR}/recipes*/*/*.bb ${LAYERDIR}/recipes*/*/*.bbappend"

BBFILE_COLLECTIONS += "shr-layer"
BBFILE_PATTERN_shr-layer := "^${LAYERDIR}/"
BBFILE_PRIORITY_shr-layer = "7"

SIGGEN_EXCLUDERECIPES_ABISAFE += "\
  libphone-ui-config \
  shr-splash \
  shr-splash-theme-logo \
  packagegroup-shr-minimal \
  e-wm-config-illume2-shr \
  shr-settings \
"

SIGGEN_EXCLUDE_SAFE_RECIPE_DEPS += "\
  gpe-theme-neo->gpe-filemanager \
  gpe-theme-neo->gpe-sketchbook \
"

# RDEPENDS on libphone-ui-shr
SIGGEN_EXCLUDE_SAFE_RECIPE_DEPS += "\
  phoneui-shr-theme-neo->libphone-ui-shr \
  phoneui-shr-theme-niebiee->libphone-ui-shr \
  phoneui-shr-theme-sowka->libphone-ui-shr \
  phoneui-shr-theme-o2->libphone-ui-shr \
"

# RDEPENDS on e-wm or gtk+
SIGGEN_EXCLUDE_SAFE_RECIPE_DEPS += "\
  e-wm-theme-illume-neo->e-wm \
  icon-theme-neo->e-wm \
  gtk-theme-neo->gtk+ \
"

# RDEPENDS on update-alternatives provider opkg-utils
SIGGEN_EXCLUDE_SAFE_RECIPE_DEPS += "\
  phoneui-shr-theme-neo->opkg-utils \
  phoneui-shr-theme-niebiee->opkg-utils \
  phoneui-shr-theme-o2->opkg-utils \
  phoneui-shr-theme-sowka->opkg-utils \
  shr-splash-theme-dontpanic->opkg-utils \
  shr-splash-theme-handy->opkg-utils \
  shr-splash-theme-niebiee->opkg-utils \
  shr-splash-theme-openmoko->opkg-utils \
  shr-splash-theme-simple->opkg-utils \
  shr-splash-theme-tux->opkg-utils \
"

HANDHELDS_CVS = "cvs://anoncvs:anoncvs@anoncvs.handhelds.org/cvs"
```

## meta-volla/conf/layer.conf
```bitbake
# We have a conf and classes directory, append to BBPATH
BBPATH .= ":${LAYERDIR}"

# We have a recipes directory, add to BBFILES
BBFILES += "${LAYERDIR}/recipes*/*/*.bb ${LAYERDIR}/recipes*/*/*.bbappend"

BBFILE_COLLECTIONS += "volla-layer"
BBFILE_PATTERN_volla-layer := "^${LAYERDIR}/"
BBFILE_PRIORITY_volla-layer = "7"

LAYERDEPENDS_volla-layer = "core openembedded-layer android-layer"

LAYERSERIES_COMPAT_volla-layer = "gatesgarth"
```

## meta-volla/conf/machine/yggdrasil.conf
```bitbake
#-----------------------------------------------------------------------------
#@TYPE: Machine
#@NAME: Volla Phone (codename yggdrasil)
#@DESCRIPTION: Machine configuration for the Volla Phone
#-----------------------------------------------------------------------------

require conf/machine/include/arm/arch-arm64.inc
require conf/machine/include/meta-android-halium.inc

PREFERRED_PROVIDER_virtual/kernel ?= "linux-volla-yggdrasil"
MACHINE_KERNEL_PR = "r0"

MACHINE_FEATURES = "apm alsa bluetooth gps usbgadget usbhost phone wifi vfat ext2 keyboard nfc"
MACHINE_DISPLAY_WIDTH_PIXELS = "1080"
MACHINE_DISPLAY_HEIGHT_PIXELS = "2340"
MACHINE_DISPLAY_ORIENTATION = "0"
MACHINE_DISPLAY_PPI = "403"

PREFERRED_VERSION_android-headers-halium = "9.0%"
VIRTUAL-RUNTIME_android-system-image = "android-system-image-yggdrasil"

PREFERRED_PROVIDER_virtual/xserver = "xserver-xorg"
XSERVER = " \
    xserver-xorg \
    xf86-input-evdev \
    xf86-video-fbdev \
"

# We need fsck.vfat for vfat partitions we need to mount
# Also, include the wlan module for the kernel
MACHINE_EXTRA_RDEPENDS = " \
    android-kernel-bootimg \
    dosfstools \
    kernel-module-wlan \
"

KERNEL_IMAGETYPE = "Image.gz-dtb"
IMAGE_FSTYPES += "tar.gz"
IMAGE_ROOTFS_EXTRA_SPACE = "200000"

ANDROID_BOARD_BOOTIMAGE_PARTITION = "/dev/block/mmcblk0p25"
ANDROID_BOARD_SYSTEMIMAGE_PARTITION_SIZE = "3758096384"
ANDROID_BOARD_FLASH_BLOCK_SIZE = "131072"

SERIAL_CONSOLE = "115200 ttyHSL0"
```

## meta-xiaomi/conf/layer.conf
```bitbake
# We have a conf and classes directory, append to BBPATH
BBPATH .= ":${LAYERDIR}"

# We have a recipes directory, add to BBFILES
BBFILES += "${LAYERDIR}/recipes*/*/*.bb ${LAYERDIR}/recipes*/*/*.bbappend"

BBFILE_COLLECTIONS += "xiaomi-layer"
BBFILE_PATTERN_xiaomi-layer := "^${LAYERDIR}/"
BBFILE_PRIORITY_xiaomi-layer = "7"

LAYERDEPENDS_xiaomi-layer = "core openembedded-layer android-layer"
```

## meta-xiaomi/conf/machine/sagit.conf
```bitbake
#-----------------------------------------------------------------------------
#@TYPE: Machine
#@NAME: Xiaomi Mi 6 (codename sagit)
#@DESCRIPTION: Machine configuration for the Xiaomi Mi 6
#-----------------------------------------------------------------------------

require conf/machine/include/arm/arch-arm64.inc
require conf/machine/include/meta-android-halium.inc

PREFERRED_PROVIDER_virtual/kernel ?= "linux-xiaomi-sagit"
MACHINE_KERNEL_PR = "r0"

MACHINE_FEATURES = "apm alsa bluetooth gps usbgadget usbhost phone wifi vfat ext2 keyboard nfc"
MACHINE_DISPLAY_WIDTH_PIXELS = "1080"
MACHINE_DISPLAY_HEIGHT_PIXELS = "1920"
MACHINE_DISPLAY_ORIENTATION = "0"
MACHINE_DISPLAY_PPI = "428"

PREFERRED_VERSION_android-headers-halium = "9.0%"
VIRTUAL-RUNTIME_android-system-image = "android-system-image-sagit"
ANDROID_HEADERS_DEFINES = "QCOM_BSP QTI_BSP QCOM_HARDWARE"

PREFERRED_PROVIDER_virtual/xserver = "xserver-xorg"
XSERVER = " \
    xserver-xorg \
    xf86-input-evdev \
    xf86-video-fbdev \
"

# We need fsck.vfat for vfat partitions we need to mount
# Also, include the wlan module for the kernel
MACHINE_EXTRA_RDEPENDS = " \
    android-kernel-bootimg \
    dosfstools \
"

# kernel-module-wlan 

KERNEL_IMAGETYPE = "Image.gz-dtb"
IMAGE_FSTYPES += "tar.gz"
IMAGE_ROOTFS_EXTRA_SPACE = "200000"

ANDROID_BOARD_BOOTIMAGE_PARTITION = "/dev/block/sde40"
ANDROID_BOARD_SYSTEMIMAGE_PARTITION_SIZE = "5368709120"
ANDROID_BOARD_FLASH_BLOCK_SIZE = "4096"

SERIAL_CONSOLE = "115200 ttyHSL0"
```
