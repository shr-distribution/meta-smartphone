## meta-greentouch/conf/layer.conf
```bitbake
# We have a conf and classes directory, append to BBPATH
BBPATH .= ":${LAYERDIR}"

# We have a recipes directory, add to BBFILES
BBFILES += "${LAYERDIR}/recipes*/*/*.bb ${LAYERDIR}/recipes*/*/*.bbappend"

BBFILE_COLLECTIONS += "greentouch-layer"
BBFILE_PATTERN_greentouch-layer := "^${LAYERDIR}/"
BBFILE_PRIORITY_greentouch-layer = "7"

LAYERDEPENDS_greentouch-layer = "core openembedded-layer android-layer"

LAYERSERIES_COMPAT_greentouch-layer = "styhead"
```

## meta-hp/conf/layer.conf
```bitbake
# We have a conf and classes directory, append to BBPATH
BBPATH .= ":${LAYERDIR}"

# We have a recipes directory, add to BBFILES
BBFILES += "${LAYERDIR}/recipes*/*/*.bb ${LAYERDIR}/recipes*/*/*.bbappend"

BBFILE_COLLECTIONS += "hp-layer"
BBFILE_PATTERN_hp-layer := "^${LAYERDIR}/"
BBFILE_PRIORITY_hp-layer = "7"

LAYERDEPENDS_hp-layer = "core openembedded-layer android-layer"

LAYERSERIES_COMPAT_hp-layer = "hardknott"
```

## meta-htc/conf/layer.conf
```bitbake
# We have a conf and classes directory, append to BBPATH
BBPATH .= ":${LAYERDIR}"

# We have a recipes directory, add to BBFILES
BBFILES += "${LAYERDIR}/recipes*/*/*.bb ${LAYERDIR}/recipes*/*/*.bbappend"

BBFILE_COLLECTIONS += "htc-layer"
BBFILE_PATTERN_htc-layer := "^${LAYERDIR}/"
BBFILE_PRIORITY_htc-layer = "7"
```

## meta-htc/conf/machine/htcdream.conf
```bitbake
#@TYPE: Machine
#@NAME: HTC Dream
#@DESCRIPTION: Machine configuration for the HTC Dream phone (aka T-Mobile G1 and Google ADP-1)

require conf/machine/include/tune-arm1136j-s.inc

MACHINE_DISPLAY_WIDTH_PIXELS = "320"
MACHINE_DISPLAY_HEIGHT_PIXELS = "480"
MACHINE_DISPLAY_ORIENTATION = "0"
MACHINE_DISPLAY_PPI = "185"

MACHINE_FEATURES = "kernel26 touchscreen screen phone gps usbgadget bluetooth wifi keyboard ext2"

module_autoload_wl1251_sdio = "wl1251_sdio"

MACHINE_EXTRA_RRECOMMENDS = "\
  kernel-module-wl1251 \
  kernel-module-wl1251-sdio \
  kernel-module-msm-wifi \
"

PREFERRED_PROVIDER_virtual/kernel = "linux-htcdream"
MACHINE_KERNEL_PR = "r3"

XSERVER = " \
        xserver-xorg \
        xserver-xorg-extension-glx \
        xserver-xorg-extension-dri \
        xf86-input-tslib \
        xf86-input-evdev \
        xf86-input-mouse \
        xf86-input-keyboard \
        xf86-video-fbdev \
"
```

## meta-htc/conf/machine/nexusone.conf
```bitbake
#@TYPE: Machine
#@NAME: Nexus One
#@DESCRIPTION: Machine configuration for Nexus One smartphone

require conf/machine/include/htc-qsd8.inc

XSERVER = " \
        xserver-xorg \
        xserver-xorg-extension-glx \
        xserver-xorg-extension-dri \
        xf86-input-evdev \
        xf86-video-fbdev \
"

MACHINE_DISPLAY_WIDTH_PIXELS = "480"
MACHINE_DISPLAY_HEIGHT_PIXELS = "800"

PREFERRED_PROVIDER_virtual/kernel = "linux-nexusone"
MACHINE_KERNEL_PR = "r4"

KERNEL_IMAGETYPE = "zImage"

MACHINE_FEATURES = "kernel26 mmc mmcroot screen touchscreen usbgadget wifi phone"

MACHINE_EXTRA_RRECOMMENDS  = "\
  kernel-module-alsa-mix-htc-leo \
  kernel-module-bcm4329 \
"

KERNEL_MODULE_AUTOLOAD += "alsa-mix-htc-leo"

#we do not autoload bcm4329:
#loading it activates the wifi card(which consumes power)
```

## meta-huawei/conf/layer.conf
```bitbake
# We have a conf and classes directory, append to BBPATH
BBPATH .= ":${LAYERDIR}"

# We have a recipes directory, add to BBFILES
BBFILES += "${LAYERDIR}/recipes*/*/*.bb ${LAYERDIR}/recipes*/*/*.bbappend"

BBFILE_COLLECTIONS += "huawei-layer"
BBFILE_PATTERN_huawei-layer := "^${LAYERDIR}/"
BBFILE_PRIORITY_huawei-layer = "7"

LAYERDEPENDS_huawei-layer = "core openembedded-layer android-layer"
```

## meta-huawei/conf/machine/angler.conf
```bitbake
#-----------------------------------------------------------------------------
#@TYPE: Machine
#@NAME: Google Nexus 6P (Huawei) (codename angler)
#@DESCRIPTION: Machine configuration for the Google Nexus 6P (Huawei)
#-----------------------------------------------------------------------------

require conf/machine/include/arm/arch-arm64.inc

PREFERRED_PROVIDER_virtual/kernel ?= "linux-huawei-angler"
MACHINE_KERNEL_PR = "r0"

MACHINE_FEATURES = "apm alsa bluetooth gps usbgadget usbhost phone wifi vfat ext2 keyboard nfc"
MACHINE_DISPLAY_WIDTH_PIXELS = "1440"
MACHINE_DISPLAY_HEIGHT_PIXELS = "2560"
MACHINE_DISPLAY_ORIENTATION = "0"
MACHINE_DISPLAY_PPI = "518"

PREFERRED_PROVIDER_virtual/libgl ?= "mesa-gl"
PREFERRED_PROVIDER_virtual/libgbm ?= "mesa-gl"
PREFERRED_PROVIDER_virtual/egl ?= "libhybris"
PREFERRED_PROVIDER_virtual/mesa ?= "libhybris"
PREFERRED_PROVIDER_virtual/libgles1 ?= "libhybris"
PREFERRED_PROVIDER_virtual/libgles2 ?= "libhybris"

# Use Halium-based init scripts
VIRTUAL-RUNTIME_android-initramfs-scripts = "initramfs-scripts-halium"

PREFERRED_PROVIDER_virtual/android-headers = "android-headers-halium"
PREFERRED_VERSION_android-headers-halium = "7.1+git%"
VIRTUAL-RUNTIME_android-system-image = "android-system-image-angler"

PREFERRED_PROVIDER_virtual/xserver = "xserver-xorg"
XSERVER = " \
    xserver-xorg \
    xf86-input-evdev \
    xf86-video-fbdev \
"

# We need fsck.vfat for vfat partitions we need to mount
# Also, include the wlan module for the kernel
MACHINE_EXTRA_RDEPENDS = " \
    android-kernel-bootimg \
    dosfstools \
"

KERNEL_IMAGETYPE = "Image.gz-dtb"
IMAGE_FSTYPES += "tar.gz"
IMAGE_ROOTFS_EXTRA_SPACE = "200000"

ANDROID_BOARD_BOOTIMAGE_PARTITION = "/dev/block/mmcblk0p34"
ANDROID_BOARD_SYSTEMIMAGE_PARTITION_SIZE = "3221225472"
ANDROID_BOARD_FLASH_BLOCK_SIZE = "131072"

SERIAL_CONSOLE = "115200 ttyHSL0"
```

## meta-leeco/conf/layer.conf
```bitbake
# We have a conf and classes directory, append to BBPATH
BBPATH .= ":${LAYERDIR}"

# We have a recipes directory, add to BBFILES
BBFILES += "${LAYERDIR}/recipes*/*/*.bb ${LAYERDIR}/recipes*/*/*.bbappend"

BBFILE_COLLECTIONS += "leeco-layer"
BBFILE_PATTERN_leeco-layer := "^${LAYERDIR}/"
BBFILE_PRIORITY_leeco-layer = "7"

LAYERDEPENDS_leeco-layer = "core openembedded-layer android-layer"

LAYERSERIES_COMPAT_leeco-layer = "gatesgarth"
```

## meta-leeco/conf/machine/s2.conf
```bitbake
#-----------------------------------------------------------------------------
#@TYPE: Machine
#@NAME: Leeco S2 (codename se)
#@DESCRIPTION: Machine configuration for the LeEco Le2
#-----------------------------------------------------------------------------

require conf/machine/include/arm/arch-arm64.inc
require conf/machine/include/meta-android-halium.inc

PREFERRED_PROVIDER_virtual/kernel ?= "linux-leeco-s2"
MACHINE_KERNEL_PR = "r0"

MACHINE_FEATURES = "apm alsa bluetooth gps usbgadget usbhost phone wifi vfat ext2 keyboard nfc"
MACHINE_DISPLAY_WIDTH_PIXELS = "1080"
MACHINE_DISPLAY_HEIGHT_PIXELS = "1920"
MACHINE_DISPLAY_ORIENTATION = "0"
MACHINE_DISPLAY_PPI = "403"

PREFERRED_VERSION_android-headers-halium = "7.1%"
VIRTUAL-RUNTIME_android-system-image = "android-system-image-s2"

PREFERRED_PROVIDER_virtual/xserver = "xserver-xorg"
XSERVER = " \
    xserver-xorg \
    xf86-input-evdev \
    xf86-video-fbdev \
"

# We need fsck.vfat for vfat partitions we need to mount
# Also, include the wlan module for the kernel
MACHINE_EXTRA_RDEPENDS = " \
    android-kernel-bootimg \
    dosfstools \
"
#    kernel-module-wlan

KERNEL_IMAGETYPE = "Image.gz-dtb"
IMAGE_FSTYPES += "tar.gz"
IMAGE_ROOTFS_EXTRA_SPACE = "200000"

ANDROID_BOARD_BOOTIMAGE_PARTITION = "/dev/block/mmcblk0p23"
ANDROID_BOARD_SYSTEMIMAGE_PARTITION_SIZE = "4294967296"
ANDROID_BOARD_FLASH_BLOCK_SIZE = "131072"

SERIAL_CONSOLE = "115200 ttyHSL0"
```

## meta-lg/conf/layer.conf
```bitbake
# We have a conf and classes directory, append to BBPATH
BBPATH .= ":${LAYERDIR}"

# We have a recipes directory, add to BBFILES
BBFILES += "${LAYERDIR}/recipes*/*/*.bb ${LAYERDIR}/recipes*/*/*.bbappend"

BBFILE_COLLECTIONS += "lg-layer"
BBFILE_PATTERN_lg-layer := "^${LAYERDIR}/"
BBFILE_PRIORITY_lg-layer = "7"
```

## meta-lg/conf/machine/hammerhead.conf
```bitbake
#-----------------------------------------------------------------------------
#@TYPE: Machine
#@NAME: LG Nexus 5 (codename hammerhead)
#@DESCRIPTION: Machine configuration for the LG Nexus 5
#-----------------------------------------------------------------------------

require conf/machine/include/meta-android-halium.inc

TARGET_ARCH = "arm"

PREFERRED_PROVIDER_virtual/kernel ?= "linux-lg-hammerhead"
MACHINE_KERNEL_PR = "r0"

MACHINE_FEATURES = "kernel26 apm alsa bluetooth gps usbgadget usbhost phone wifi vfat ext2 keyboard nfc"
MACHINE_DISPLAY_WIDTH_PIXELS = "1920"
MACHINE_DISPLAY_HEIGHT_PIXELS = "1080"
MACHINE_DISPLAY_ORIENTATION = "0"
MACHINE_DISPLAY_PPI = "445"

PREFERRED_VERSION_android-headers-halium = "9.0%"
VIRTUAL-RUNTIME_android-system-image = "android-system-image-hammerhead"

PREFERRED_PROVIDER_virtual/xserver = "xserver-xorg"
XSERVER = " \
    xserver-xorg \
    xf86-input-evdev \
    xf86-video-fbdev \
"

# We need fsck.vfat for vfat partitions we need to mount
# Also, include the wlan module for the kernel
MACHINE_EXTRA_RDEPENDS = " \
    android-kernel-bootimg \
    dosfstools \
    kernel-module-bcmdhd \
"

# For Nexus 5, we need to build the dtb together with the zImage
KERNEL_IMAGETYPE = "zImage-dtb"
IMAGE_FSTYPES += "tar.gz"
IMAGE_ROOTFS_EXTRA_SPACE = "200000"

ANDROID_BOARD_BOOTIMAGE_PARTITION = "/dev/block/mmcblk0p19"
ANDROID_BOARD_SYSTEMIMAGE_PARTITION_SIZE = "1073741824"
ANDROID_BOARD_FLASH_BLOCK_SIZE = "131072"

SERIAL_CONSOLE = "115200 ttyHSL0"

require conf/machine/include/tune-cortexa8.inc
```
