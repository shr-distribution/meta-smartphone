## meta-asus/conf/machine/tilapia.conf
```bitbake
#-----------------------------------------------------------------------------
#@TYPE: Machine
#@NAME: Asus Tilapia (also known as Google Nexus 7 Mobile)
#@DESCRIPTION: Machine configuration for the Asus Tilapia
#-----------------------------------------------------------------------------

require conf/machine/include/grouper.inc

# The tilapia has a modem packed so it has "phone" functionality.
MACHINE_FEATURES += "phone"

VIRTUAL-RUNTIME_android-system-image ?= "android-system-image-tilapia"
```

## meta-aurora/conf/layer.conf
```bitbake
# We have a conf and classes directory, append to BBPATH
BBPATH .= ":${LAYERDIR}"

# We have a recipes directory, add to BBFILES
BBFILES += "${LAYERDIR}/recipes*/*/*.bb ${LAYERDIR}/recipes*/*/*.bbappend"

BBFILE_COLLECTIONS += "aurora-layer"
BBFILE_PATTERN_aurora-layer := "^${LAYERDIR}/"
BBFILE_PRIORITY_aurora-layer = "8"

LAYERDEPENDS_aurora-layer = "core openembedded-layer qt4 fso-layer shr-layer"
```

## meta-fso/conf/distro/include/fso-autorev.inc
```bitbake
# FSO
FSO_CORNUCOPIA_SRCREV = "${AUTOREV}"
FSO_PYTHONHELPERS_SRCREV = "${AUTOREV}"

SRCREV_pn-android-image-utils-native = "${AUTOREV}"
SRCREV_pn-android-rpc = "${AUTOREV}"
SRCREV_pn-cmtspeechtest = "${AUTOREV}"
SRCREV_pn-dbus-hlid = "${AUTOREV}"
SRCREV_pn-frameworkd = "${AUTOREV}"
SRCREV_pn-frameworkd-devel = "${AUTOREV}"
SRCREV_pn-fso-alsa = "${AUTOREV}"
SRCREV_pn-fso-gsm0710muxd = "${AUTOREV}"
SRCREV_pn-fso-gpsd = "${AUTOREV}"
SRCREV_pn-fso-monitord = "${AUTOREV}"
SRCREV_pn-fso-sounds = "${AUTOREV}"
SRCREV_pn-fso-specs = "${AUTOREV}"
SRCREV_pn-gsmd2 = "${AUTOREV}"
SRCREV_pn-illume-theme-freesmartphone = "${AUTOREV}"
SRCREV_pn-libascenario = "${AUTOREV}"
# SRCREV_pn-libeflvala = "${AUTOREV}"
SRCREV_pn-libframeworkd-glib = "${AUTOREV}"
SRCREV_pn-libfso-glib = "${AUTOREV}"
# SRCREV_pn-libgee-native = "${AUTOREV}"
# SRCREV_pn-libgee = "${AUTOREV}"
SRCREV_pn-libgsm0710 = "${AUTOREV}"
SRCREV_pn-libgisi = "${AUTOREV}"
SRCREV_pn-libmsmcomm = "${AUTOREV}"
SRCREV_pn-libpersistence = "${AUTOREV}"
SRCREV_pn-misc-vapi = "${AUTOREV}"
SRCREV_pn-msmcommd = "${AUTOREV}"
SRCREV_pn-msmcommd-specs = "${AUTOREV}"
SRCREV_pn-libmsmcomm = "${AUTOREV}"
SRCREV_pn-vala-dbus-binding-tool-native = "${AUTOREV}"
SRCREV_pn-vala-dbus-binding-tool = "${AUTOREV}"
SRCREV_pn-vala = "${AUTOREV}"
SRCREV_pn-zhone = "${AUTOREV}"
SRCREV_pn-zhone2 = "${AUTOREV}"
SRCREV_pn-libsamsung-ipc = "${AUTOREV}"

PREFERRED_VERSION_frameworkd = "0.11.99+git%"
PREFERRED_VERSION_frameworkd-config = "0.11.99+git%"
PREFERRED_VERSION_fsoaudiod = "0.11.99+git%"
PREFERRED_VERSION_fsodatad = "0.11.99+git%"
PREFERRED_VERSION_fsodeviced-modules = "0.11.99"
PREFERRED_VERSION_fsodeviced = "0.11.99+git%"
PREFERRED_VERSION_fsogsmd-modules = "0.11.99"
PREFERRED_VERSION_fsogsmd = "0.11.99+git%"
PREFERRED_VERSION_fsonetworkd = "0.11.99+git%"
PREFERRED_VERSION_fsosystemd = "0.11.99+git%"
PREFERRED_VERSION_fsotdld = "0.11.99+git%"
PREFERRED_VERSION_fsousaged = "0.11.99+git%"
PREFERRED_VERSION_libfsobasics = "0.11.99+git%"
PREFERRED_VERSION_libfsoframework = "0.11.99+git%"
PREFERRED_VERSION_libfsoresource = "0.11.99+git%"
PREFERRED_VERSION_libfsosystem = "0.11.99+git%"
PREFERRED_VERSION_libfsotransport = "0.11.99+git%"
PREFERRED_VERSION_libgsm0710mux = "0.11.99+git%"

PREFERRED_VERSION_libmsmcomm = "0.10.0+git%"
PREFERRED_VERSION_libmsmhll = "0.10.0+git%"
PREFERRED_VERSION_libmsmrpc = "0.1.0+git%"
PREFERRED_VERSION_msmcommd-specs = "0.10.0+git%"
PREFERRED_VERSION_msmcommd = "0.10.0+git%"

PREFERRED_VERSION_libgsm0710 = "1.2.2+git%"
PREFERRED_VERSION_fso-specs = "2012.05.24.1+git%"
# change of this needs at least 3 recipes to be rebuild/PR bumped
# meta-smartphone/meta-shr/recipes-shr/shr/libphone-ui-shr_git.bb
# meta-smartphone/meta-shr/recipes-shr/shr/libphone-ui_git.bb
# meta-smartphone/meta-shr/recipes-shr/shr/phonefsod_git.bb
PREFERRED_VERSION_libfso-glib = "2012.05.24.1+git%"
PREFERRED_VERSION_libgisi = "0.1.99+git%"
PREFERRED_VERSION_libsamsung-ipc = "0.1.0+git%"

# this switch of P_V needs at least 3 recipes to be rebuild/PR bumped
# meta-smartphone/meta-shr/recipes-shr/shr/libphone-ui-shr_git.bb
# openembedded-core/meta/recipes-connectivity/libpcap/libpcap_1.2.1.bb
# openembedded-core/meta/recipes-connectivity/wpa-supplicant/wpa-supplicant_0.7.3.bb
PREFERRED_VERSION_libnl_forcevariable = "3%"
```

## meta-geeksphone/conf/machine/geeksphone-one.conf
```bitbake
#@TYPE: Machine
#@NAME: Geeksphone One
#@DESCRIPTION: Machine configuration for Geeksphone One

#CPU
TARGET_ARCH = "arm"
require conf/machine/include/tune-arm1136j-s.inc

PREFERRED_PROVIDER_virtual/kernel = "linux-geeksphone-one"

MACHINE_DISPLAY_WIDTH_PIXELS = "240"
MACHINE_DISPLAY_HEIGHT_PIXELS = "400"

IMAGE_DEV_MANAGER_geeksphone-one = ""

MACHINE_FEATURES = "kernel26 mmc mmcroot screen phone gps usbgadget bluetooth wifi keyboard"

# xserver
PREFERRED_PROVIDER_virtual/xserver = "xserver-xorg"

XSERVER = " \
        xserver-xorg \
        xf86-input-evdev \
        xf86-input-mouse \
        xf86-input-keyboard \
        xf86-video-fbdev \
"
```
