## conf/distro/include/preferred-shr-versions.inc
```bitbake
# Upgraded
# use newer version then preferred by default
PREFERRED_VERSION_libmikmod = "3.2.0-beta2"
PREFERRED_VERSION_strace = "4.5.15"
PREFERRED_VERSION_emacs-x11 = "23.1"
PREFERRED_VERSION_glib-2.0 = "2.29%"
PREFERRED_VERSION_glib-2.0-native = "2.29%"

# we need new headers for libc, now OLDEST_KERNEL_linux-gnueabi = "2.6.24"
# and 2.6.31 for fsodeviced
LINUX_LIBC_HEADERS_VERSION ?= "2.6.32"

ANGSTROM_QT_VERSION ?= "4.7.2"
PREFERRED_VERSION_qt4-tools-native = "${ANGSTROM_QT_VERSION}"
PREFERRED_VERSION_qt4-tools-sdk = "${ANGSTROM_QT_VERSION}"
PREFERRED_VERSION_qt4-embedded = "${ANGSTROM_QT_VERSION}"
PREFERRED_VERSION_qt4-embedded-gles = "${ANGSTROM_QT_VERSION}"
PREFERRED_VERSION_qt4-x11-free = "${ANGSTROM_QT_VERSION}"
PREFERRED_VERSION_qt4-x11-free-gles = "${ANGSTROM_QT_VERSION}"

# git version fails to build
PREFERRED_VERSION_mupdf = "0.6"

# Downgraded
PREFERRED_VERSION_pulseaudio = "0.9.15"

# Prefer gcc from meta-oe
GCCVERSION ?= "4.5"
```

## conf/distro/include/sane-feed-ipk.inc
```bitbake
INHERIT += "package_ipk"

PREFERRED_PROVIDER_virtual/update-alternatives ?= "update-alternatives-cworth"
PREFERRED_PROVIDER_virtual/update-alternatives-native ?= "opkg-native"
VIRTUAL-RUNTIME_update-alternatives ?= "update-alternatives-cworth"
```

## conf/distro/shr.conf
```bitbake
#-----------------------------------------------------------------------------
#@TYPE: Distribution
#@NAME: SHR
#@DESCRIPTION: Linux Distribution Configuration for Mobile Phones
#-----------------------------------------------------------------------------

# Set the toolchain type (internal, external) and brand (generic, csl etc.)
TOOLCHAIN_TYPE ?= "internal"
TOOLCHAIN_BRAND ?= ""

BB_LOCALCOUNT_OVERRIDE = ""
require conf/distro/include/preferred-shr-versions.inc
require conf/distro/include/efl-from-svn.inc

#
# Header
#
DISTRO_NAME = "shr"
DISTRO_VERSION = "-${DATE}"
DISTRO_REVISION = "2"
DISTRO_PR = ".6"
DISTRO_TYPE = "release"
DISTRO = "shr"

DISTRO_SSH_DAEMON = "openssh"
DISTRO_APM = "fso-apm"

#Generate locales on the buildsystem instead of on the target. Speeds up first boot, set to "1" to enable
ENABLE_BINARY_LOCALE_GENERATION ?= "1"

# We only want to build UTF8 locales
LOCALE_UTF8_ONLY = "1"

#save statistical info on images
INHERIT += "testlab"

#activate the blacklister
INHERIT += "blacklist"

#have a shared state a.k.a package-staging2
INHERIT += "sstate"

#run QA tests on builds and packages and log them
INHERIT += "insane"
# INHERIT += "packagehistory"
QA_LOG = "1"

#make devshell available as task
INHERIT += "devshell"

#run QA tests on recipes
#INHERIT += "recipe_sanity"

BLACKLIST_pn-bluez-libs  = "bluez-libs 3.x has been replaced by bluez4"
BLACKLIST_pn-bluez-utils = "bluez-utils 3.x has been replaced by bluez4"
BLACKLIST_pn-atd = "atd has been replaced by atd-over-fso"
BLACKLIST_pn-qt4-x11-free-gles = "qt4-x11-free is fine even without gles"
BLACKLIST_pn-collie-kernel-48-16 = "kernel-2.4.* is too old and gcc-2.95 is gone"
BLACKLIST_pn-openzaurus-pxa27x = "kernel-2.4.* is too old and gcc-2.95 is gone"
BLACKLIST_pn-corgi-kernel-2.4-embedix = "kernel-2.4.* is too old and gcc-2.95 is gone"
BLACKLIST_pn-collie-kernel-32-32 = "kernel-2.4.* is too old and gcc-2.95 is gone"
BLACKLIST_pn-shepherd-kernel-2.4-embedix = "kernel-2.4.* is too old and gcc-2.95 is gone"
BLACKLIST_pn-collie-kernel-58-6 = "kernel-2.4.* is too old and gcc-2.95 is gone"
BLACKLIST_pn-husky-kernel-2.4-embedix = "kernel-2.4.* is too old and gcc-2.95 is gone"
BLACKLIST_pn-collie-kernel-24-8 = "kernel-2.4.* is too old and gcc-2.95 is gone"
BLACKLIST_pn-poodle-kernel-2.4-embedix = "kernel-2.4.* is too old and gcc-2.95 is gone"
BLACKLIST_pn-openzaurus-pxa = "kernel-2.4.* is too old and gcc-2.95 is gone"
BLACKLIST_pn-collie-kernel-40-24 = "kernel-2.4.* is too old and gcc-2.95 is gone"
BLACKLIST_pn-poodle255-kernel-2.4-embedix = "kernel-2.4.* is too old and gcc-2.95 is gone"
BLACKLIST_pn-openzaurus-sa = "kernel-2.4.* is too old and gcc-2.95 is gone"
BLACKLIST_pn-collie-kernel-32-0 = "kernel-2.4.* is too old and gcc-2.95 is gone"
BLACKLIST_pn-collie-kernel-64-0 = "kernel-2.4.* is too old and gcc-2.95 is gone"
BLACKLIST_pn-collie-kernel-58-6-debug = "kernel-2.4.* is too old and gcc-2.95 is gone"
BLACKLIST_pn-c7x0-kernels-2.4-embedix = "kernel-2.4.* is too old and gcc-2.95 is gone"
BLACKLIST_pn-collie-kernels-2.4-embedix = "kernel-2.4.* is too old and gcc-2.95 is gone"
BLACKLIST_pn-linux-jlime-current = "strange kernel, spank maintainer"
BLACKLIST_pn-linux-ml403-mvista-2.6.x = "strange kernel, spank maintainer"
BLACKLIST_pn-linux-davinci = "strange kernel, spank maintainer"
BLACKLIST_pn-xserver-xf86-lite = "xorg-xserver is preferred"
BLACKLIST_pn-gdk-pixbuf = "gdk-pixbuf packages are provided by gtk now"
BLACKLIST_pn-gdk-pixbuf-native = "gdk-pixbuf packages are provided by gtk now"
BLACKLIST_pn-libiconv = "libiconv is provided by LIBC"
BLACKLIST_pn-libiconv-native = "libiconv-native is provided by host LIBC (no provider in OE)"

# pango depends on virtual/libiconv and BBCLASSEXTEND=native makes virtual/libiconv-native from it and we don't want libiconv-native
ASSUME_PROVIDED += "virtual/libiconv-native"

CVS_TARBALL_STASH += "http://build.shr-project.org/sources/"

#The shr-mirrors.bbclass repleaces this
#PREMIRRORS = "(ftp|https?)$://.*/.* http://build.shr-project.org/sources/"
INHERIT += "shr-mirrors" 


DISTRO_FEED_PREFIX ?= "shr-dev"
DISTRO_FEED_URI ?= "http://build.shr-project.org/shr-testing/ipk"

AB_DEPLOY_EXTRA ?= ""
DEPLOY_DIR_IMAGE = "${DEPLOY_DIR}/images/${MACHINE_ARCH}/${AB_DEPLOY_EXTRA}"

IPKG_VARIANT = "opkg"

ESYSACTIONS = "e-wm-sysactions-shr"
EMENU = "e-wm-menu-shr"
ECONFIG = "e-wm-config-illume2-shr"
ETHEME = "e-wm-theme-illume-gry"

# From minimal.conf

#############################################################################
# FEATURE SELECTION
#############################################################################
# Use bluetooth 4.0
DISTRO_BLUETOOTH_MANAGER = "bluez4"
# We want images supporting the following features (for task-base)
DISTRO_FEATURES = "largefile ipv4 ipv6 wifi ppp ext2 vfat bluetooth usbgadget usbhost"
# Following features are for ARM and E500 based machines
DISTRO_FEATURES += " eabi "
# Use-like features
DISTRO_FEATURES += " tk "

#############################################################################
# LIBRARY NAMES
#############################################################################
# libfoo -> libfoo0-2 (etc)
INHERIT += "debian"

#############################################################################
# PACKAGING & FEEDS
#############################################################################
# Chose the packaging system
IMAGE_FSTYPES ?= "tar.gz jffs2"

require conf/distro/include/sane-feed.inc
PREFERRED_PKG_FORMAT ?= "ipk"
require conf/distro/include/sane-feed-${PREFERRED_PKG_FORMAT}.inc

#############################################################################
# IMAGES
#############################################################################
# Name the generated images in a sane way
IMAGE_NAME = "${DISTRO_NAME}-${IMAGE_BASENAME}-${LIBC}-${PREFERRED_PKG_FORMAT}-${DISTRO_VERSION}-${MACHINE}"
CACHE ?= "${TMPDIR}/cache/${LIBC}/${MACHINE}"
DEPLOY_DIR ?= "${TMPDIR}/deploy/${LIBC}"
DEPLOY_DIR_IMAGE = "${DEPLOY_DIR}/images/${MACHINE}"

# increase inode/block ratio for ext2 filesystem 
EXTRA_IMAGECMD_ext2 = "-i 8192"

#############################################################################
# KERNEL
#############################################################################
KERNEL = "kernel26"
MACHINE_KERNEL_VERSION = "2.6"

#############################################################################
# Ensure MACHINE_CLASS is in OVERRIDES
#############################################################################
MACHINE_CLASS ?= ""
MACHINE_OVERRIDES += "${MACHINE_CLASS}"

#############################################################################
# TOOLCHAIN
#############################################################################
LIBC ?= "eglibc"
require conf/distro/include/sane-toolchain.inc
require conf/distro/include/arm-thumb.inc

# Set some java bits
require conf/distro/include/sane-toolchain-java.inc


#############################################################################
# PREFERRED PROVIDERS
#############################################################################
PREFERRED_PROVIDER_gpsd = "fso-gpsd"
PREFERRED_PROVIDER_atd = "atd-over-fso"
PREFERRED_PROVIDER_opkg = "opkg"
# virtual/libgl is used ie in xorg-xserver which is not MACHINE_ARCH so we need to keep it consistent across multiple machines using same xorg-xserver
PREFERRED_PROVIDER_virtual/libgl = "mesa-dri"

#############################################################################
# CONTENTS
#############################################################################

# Ship extra debug utils in the rootfs when doing a debug build 
DISTRO_EXTRA_APPS ?= ""
DISTRO_EXTRA_APPS += '${@base_conditional("DISTRO_TYPE", "release", "", "task-cli-tools-debug",d)}'

# Additional content I (only valid if you include task-base)
# distro-feed-configs: configuration files for the online feeds
# util-linux-mount util-linux-umount: busybox mount is broken
DISTRO_EXTRA_RDEPENDS += "\
  shr-version \
  distro-feed-configs \
  util-linux-mount util-linux-umount \
  ${DISTRO_EXTRA_APPS} \
"
PREFERRED_PROVIDER_virtual/arm-oe-linux-gnueabi-libc-for-gcc = "eglibc"
PREFERRED_PROVIDER_virtual/arm-oe-linux-gnueabi-libc-initial = "eglibc-initial"
PREFERRED_PROVIDER_virtual/libc-nativesdk = "eglibc-nativesdk"
PREFERRED_PROVIDER_virtual/x86_64-pokysdk-linux-libc-for-gcc-nativesdk = "eglibc-nativesdk"
PREFERRED_PROVIDER_glib-2.0-utils = "glib-2.0"
PREFERRED_PROVIDER_gconf-native = "gconf-native"
PREFERRED_PROVIDER_libfribidi = "libfribidi"
PREFERRED_PROVIDER_opkg-native = "opkg-native"
PREFERRED_PROVIDER_virtual/libc = "eglibc"
PREFERRED_PROVIDER_gconf = "gconf"
PREFERRED_PROVIDER_virtual/libx11 = "libx11"
PREFERRED_PROVIDER_linux-libc-headers-nativesdk = "linux-libc-headers-nativesdk"
PREFERRED_PROVIDER_virtual/x86_64-pokysdk-linux-libc-initial-nativesdk = "eglibc-initial-nativesdk"
PREFERRED_PROVIDER_glibc-charmap-utf-8 = "eglibc"
PREFERRED_PROVIDER_virtual/xserver-xf86 = "xserver-xorg"
```

## meta-acer/conf/layer.conf
```bitbake
# We have a conf and classes directory, append to BBPATH
BBPATH .= ":${LAYERDIR}"

# We have a recipes directory, add to BBFILES
BBFILES += "${LAYERDIR}/recipes*/*/*.bb ${LAYERDIR}/recipes*/*/*.bbappend"

BBFILE_COLLECTIONS += "acer-layer"
BBFILE_PATTERN_acer-layer := "^${LAYERDIR}/"
BBFILE_PRIORITY_acer-layer = "17"
```

## meta-acer/conf/machine/a500.conf
```bitbake
#-----------------------------------------------------------------------------
#@TYPE: Machine
#@NAME: Acer IconiaTab A500
#@DESCRIPTION: Machine configuration for the Acer IconiaTab A500
#-----------------------------------------------------------------------------

TARGET_ARCH = "arm"

PREFERRED_PROVIDER_virtual/kernel ?= "linux-acer-a500"
MACHINE_KERNEL_PR = "r1"

MACHINE_FEATURES = "kernel26 apm alsa bluetooth gps usbgadget usbhost wifi vfat ext2 keyboard"
MACHINE_DISPLAY_WIDTH_PIXELS = "1280"
MACHINE_DISPLAY_HEIGHT_PIXELS = "800"
MACHINE_DISPLAY_ORIENTATION = "0"
MACHINE_DISPLAY_PPI = "149"

# Reminder: acer-a500-firmware dependancy is to be added back when the corresponding recipe will be available
# MACHINE_EXTRA_RDEPENDS = ""

PREFERRED_PROVIDER_virtual/egl ?= "libhybris"
PREFERRED_PROVIDER_virtual/libgles2 ?= "libhybris"
VIRTUAL-RUNTIME_android-system-image ?= "android-system-image-a500"

PREFERRED_PROVIDER_virtual/xserver = "xserver-xorg"
XSERVER = " \
    xserver-xorg \
    xf86-input-evdev \
"

KERNEL_IMAGETYPE = "zImage"
IMAGE_FSTYPES += "tar.gz"
IMAGE_ROOTFS_EXTRA_SPACE = "200000"

ANDROID_BOOTIMG_KERNEL_RAM_BASE = "0x10000000"
ANDROID_BOOTIMG_CMDLINE = "tegraid=20.1.3.0.0 mem=1024M@0M video=tegrafb debug_uartport=hsport usbcore.old_scheme_first=1 lp0_vec=8192@0x3d805000 tegra_fbmem=8197120@0x3d81c000 brand=acer target_product=a500_ww_gen1 tegraboot=sdmmc gpt gpt_sector=62320639 androidboot.carrier=wifi-only bootloader_ver=0.03.14-MUL root=/dev/mmcblk1p2 rootwait"
ANDROID_EXTRA_INITRAMFS_IMAGE_INSTALL = "udev e2fsprogs-e2fsck e2fsprogs-resize2fs"

ANDROID_BOARD_SYSTEMIMAGE_PARTITION_SIZE = "1283457024"
ANDROID_BOARD_FLASH_BLOCK_SIZE = "131072"

SERIAL_CONSOLE = "115200 ttyFIQ0"

# The A500 tablet has a Tegra2 processor, which doesn't support the Neon ARM extension.
# So override the target architecture, and use a armv7a-vfp package architecture.
# Of course this means that a package built for the tuna or grouper machines is likely to
# not run on the A500.
DEFAULTTUNE ?= "cortexa9"
require conf/machine/include/tune-cortexa9.inc
```

## meta-asus/conf/layer.conf
```bitbake
# We have a conf and classes directory, append to BBPATH
BBPATH .= ":${LAYERDIR}"

# We have a recipes directory, add to BBFILES
BBFILES += "${LAYERDIR}/recipes*/*/*.bb ${LAYERDIR}/recipes*/*/*.bbappend"

BBFILE_COLLECTIONS += "asus-layer"
BBFILE_PATTERN_asus-layer := "^${LAYERDIR}/"
BBFILE_PRIORITY_asus-layer = "7"
```

## meta-asus/conf/machine/grouper.conf
```bitbake
#-----------------------------------------------------------------------------
#@TYPE: Machine
#@NAME: Asus Grouper (also known as Google Nexus 7 WiFi)
#@DESCRIPTION: Machine configuration for the Asus Grouper
#-----------------------------------------------------------------------------

require conf/machine/include/grouper.inc

VIRTUAL-RUNTIME_android-system-image ?= "android-system-image-grouper"
```

## meta-asus/conf/machine/include/grouper.inc
```bitbake
#-----------------------------------------------------------------------------
#@TYPE: Machine
#@NAME: Asus Grouper (also known as Google Nexus 7)
#@DESCRIPTION: Machine configuration for the Asus Grouper
#-----------------------------------------------------------------------------

TARGET_ARCH = "arm"

MACHINE_CLASS = "grouper"

PREFERRED_PROVIDER_virtual/kernel ?= "linux-asus-grouper"
MACHINE_KERNEL_PR = "r1"

MACHINE_FEATURES = "kernel26 apm alsa bluetooth gps usbgadget usbhost wifi vfat ext2"
MACHINE_DISPLAY_WIDTH_PIXELS = "800"
MACHINE_DISPLAY_HEIGHT_PIXELS = "1280"
MACHINE_DISPLAY_ORIENTATION = "0"
MACHINE_DISPLAY_PPI = "233"

MACHINE_EXTRA_RDEPENDS = "asus-grouper-firmware"

PREFERRED_PROVIDER_virtual/egl ?= "libhybris"
PREFERRED_PROVIDER_virtual/mesa ?= "libhybris"
PREFERRED_PROVIDER_virtual/libgles1 ?= "libhybris"
PREFERRED_PROVIDER_virtual/libgles2 ?= "libhybris"

PREFERRED_PROVIDER_virtual/android-headers = "android-headers-grouper"
VIRTUAL-RUNTIME_android-system-image ?= "android-system-image-grouper"

PREFERRED_PROVIDER_virtual/xserver = "xserver-xorg"
XSERVER = " \
    xserver-xorg \
    xf86-input-evdev \
"

KERNEL_IMAGETYPE = "zImage"
IMAGE_FSTYPES += "tar.gz ext2 ext4"
IMAGE_ROOTFS_EXTRA_SPACE = "200000"

ANDROID_BOOTIMG_CMDLINE = "console=tty1"
ANDROID_BOOTIMG_KERNEL_RAM_BASE = "0x10008000"
ANDROID_BOOTIMG_RAMDISK_RAM_BASE = "0x11000000"
ANDROID_BOOTIMG_SECOND_RAM_BASE = "0x10f00000"
ANDROID_BOOTIMG_TAGS_RAM_BASE = "0x10000100"
ANDROID_BOOTIMG_BOOT_PARTITION = "/dev/mmcblk0p2"
ANDROID_EXTRA_INITRAMFS_IMAGE_INSTALL = "udev e2fsprogs-e2fsck e2fsprogs-resize2fs"

ANDROID_BOARD_BOOTIMAGE_PARTITION = "/dev/block/mmcblk0p2"
ANDROID_BOARD_SYSTEMIMAGE_PARTITION_SIZE = "681574400"
ANDROID_BOARD_FLASH_BLOCK_SIZE = "4096"

require conf/machine/include/tune-cortexa8.inc
```
